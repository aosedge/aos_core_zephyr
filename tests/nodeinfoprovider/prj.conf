## CMakeLists.txt
```
# SPDX-License-Identifier: Apache-2.0

cmake_minimum_required(VERSION 3.20.0)
find_package(Zephyr REQUIRED HINTS $ENV{ZEPHYR_BASE})

project(nodeinfoprovider_test)

# ######################################################################################################################
# Config
# ######################################################################################################################

set(aoscore_config aoscoreconfig.hpp)
set(aoscore_source_dir "${CMAKE_CURRENT_SOURCE_DIR}/../../../aos_core_lib_cpp")

# ######################################################################################################################
# Definitions
# ######################################################################################################################

# Aos core configuration
add_definitions(-include ${aoscore_config})

# ######################################################################################################################
# Includes
# ######################################################################################################################

zephyr_include_directories(${aoscore_source_dir}/include)
zephyr_include_directories(${APPLICATION_SOURCE_DIR}/..)
zephyr_include_directories(${APPLICATION_SOURCE_DIR}/../../src)
zephyr_include_directories(${APPLICATION_SOURCE_DIR}/src)
zephyr_include_directories_ifdef(CONFIG_NATIVE_APPLICATION ${APPLICATION_SOURCE_DIR}/../../mocks/include)

# ######################################################################################################################
# Target
# ######################################################################################################################

target_sources(
    app
    PRIVATE ../../src/nodeinfoprovider/nodeinfoprovider.cpp
            ../../src/utils/utils.cpp
            ../utils/log.cpp
            src/main.cpp
            ${aoscore_source_dir}/src/common/tools/fs.cpp
            ${aoscore_source_dir}/src/common/tools/time.cpp
            ${aoscore_source_dir}/src/common/tools/uuid.cpp
)

target_sources_ifdef(CONFIG_NATIVE_APPLICATION app PRIVATE ${APPLICATION_SOURCE_DIR}/../../mocks/xstat/xstat.cpp)
```

## Kconfig
```
# Copyright (C) 2024 Renesas Electronics Corporation.
# Copyright (C) 2024 EPAM Systems, Inc.
#
# SPDX-License-Identifier: Apache-2.0

mainmenu "Aos zephyr application"

config AOS_NODE_TYPE
	string "Node type"
	default "NODE_NAME"

config AOS_NODE_NAME
	string "Node name"
	default "NODE_NAME"

config AOS_MAX_CPU_DMIPS
	int "Maximum CPU DMIPS"
	default 10000

config AOS_DISK_MOUNT_POINT
	string "Disk mount point"
	default ".aos"

config AOS_NODE_STATUS_FILE
	string "Path to provisioning state file."
	default ".aos/.nodestatus"

config AOS_NODE_ID_FILE
	string "Path to node id file."
	default ".aos/.nodeid"

source "Kconfig"
```

## prj.conf
```kconfig
# Enable C++
CONFIG_CPP=y
CONFIG_STD_CPP17=y

# Enable test suit
CONFIG_ZTEST=y

# Enable JSON library
CONFIG_JSON_LIBRARY=y

# Enable file system
CONFIG_FLASH=y
CONFIG_FLASH_MAP=y
CONFIG_FILE_SYSTEM=y
CONFIG_FILE_SYSTEM_LITTLEFS=y



# Enable hardware info
CONFIG_HWINFO=y
```

## src/main.cpp
```c
/*
 * Copyright (C) 2024 Renesas Electronics Corporation.
 * Copyright (C) 2024 EPAM Systems, Inc.
 *
 * SPDX-License-Identifier: Apache-2.0
 */

#include <fcntl.h>
#include <sys/statvfs.h>

#include <zephyr/tc_util.h>
#include <zephyr/ztest.h>

#include <aos/common/tools/fs.hpp>
#include <aos/common/tools/log.hpp>
#include <aos/common/tools/string.hpp>
#include <aos/common/types.hpp>

#include "nodeinfoprovider/nodeinfoprovider.hpp"
#include "utils/log.hpp"
#include "utils/utils.hpp"

namespace aos::zephyr {

/***********************************************************************************************************************
 * Consts
 **********************************************************************************************************************/

static constexpr auto cNodeStatusFile = CONFIG_AOS_NODE_STATUS_FILE;
static constexpr auto cNodeIDFile     = CONFIG_AOS_NODE_ID_FILE;
static constexpr auto cUnprovisioned  = "unprovisioned";
static constexpr auto cTestNodeID     = "test-id";

/***********************************************************************************************************************
 * Static
 **********************************************************************************************************************/

void* setup(void)
{
    aos::Log::SetCallback(TestLogCallback);

    auto err = aos::fs::ClearDir(CONFIG_AOS_DISK_MOUNT_POINT);
    zassert_true(err.IsNone(), "Failed to clear disk mount point: %s", utils::ErrorToCStr(err));

    return NULL;
}

void teardown(void* data)
{
    auto err = aos::fs::RemoveAll(CONFIG_AOS_DISK_MOUNT_POINT);
    zassert_true(err.IsNone(), "Failed to remove disk mount point: %s", utils::ErrorToCStr(err));
}

void before_test(void* data)
{
    auto err = aos::fs::WriteStringToFile(cNodeStatusFile, cUnprovisioned, S_IRUSR | S_IWUSR);
    zassert_true(err.IsNone(), "Failed to create provisioning state file: %s", utils::ErrorToCStr(err));

    err = aos::fs::WriteStringToFile(cNodeIDFile, cTestNodeID, S_IRUSR | S_IWUSR);
    zassert_true(err.IsNone(), "Failed to create node id file: %s", utils::ErrorToCStr(err));
}

/***********************************************************************************************************************
 * Types
 **********************************************************************************************************************/

class StubUUIDProvider : public aos::crypto::UUIDItf {
public:
    RetWithError<uuid::UUID> CreateUUIDv4() override
    {
        static uuid::UUID uuid {uuid::cUUIDSize};
        ++uuid.Back();

        return uuid;
    }

    RetWithError<uuid::UUID> CreateUUIDv5(const uuid::UUID& space, const Array<uint8_t>& name) override
    {
        static uuid::UUID uuid {uuid::cUUIDSize};
        ++uuid.Back();

        return uuid;
    }
};

class TestNodeStatusObserver : public aos::iam::nodeinfoprovider::NodeStatusObserverItf {
public:
    Error OnNodeStatusChanged(const aos::String& nodeID, const aos::NodeStatus& status) override
    {
        mNodeID     = nodeID;
        mNodeStatus = status;
        mNotified   = true;

        return ErrorEnum::eNone;
    }

    void Reset()
    {
        mNotified = false;
        mNodeID.Clear();
        mNodeStatus = aos::NodeStatus();
    }

    aos::StaticString<aos::cNodeIDLen> mNodeID;
    aos::NodeStatus                    mNodeStatus;
    bool                               mNotified = false;
};

/***********************************************************************************************************************
 * Setup
 **********************************************************************************************************************/

ZTEST_SUITE(nodeinfoprovider, nullptr, setup, before_test, nullptr, teardown);

/***********************************************************************************************************************
 * Tests
 **********************************************************************************************************************/

ZTEST(nodeinfoprovider, test_node_info)
{
    StubUUIDProvider                   uuidProvider;
    nodeinfoprovider::NodeInfoProvider provider;

    auto err = provider.Init(uuidProvider);
    zassert_true(err.IsNone(), "Failed to init node info provider: %s", utils::ErrorToCStr(err));

    aos::NodeInfo nodeInfo;
    err = provider.GetNodeInfo(nodeInfo);

    zassert_true(err.IsNone(), "Failed to get node info: %s", utils::ErrorToCStr(err));

    zassert_equal(nodeInfo.mNodeID, cTestNodeID, "Node ID mismatch");

    zassert_equal(nodeInfo.mStatus.GetValue(), aos::NodeStatusEnum::eUnprovisioned, "Node status mismatch");
    zassert_equal(nodeInfo.mMaxDMIPS, CONFIG_AOS_MAX_CPU_DMIPS, "Max DMIPS mismatch");

    // test partition info
    zassert_equal(nodeInfo.mPartitions.Size(), 1, "Expected 1 partition");
    zassert_equal(nodeInfo.mPartitions[0].mName, "aos", "Partition name mismatch");
    zassert_equal(nodeInfo.mPartitions[0].mPath, CONFIG_AOS_DISK_MOUNT_POINT, "Partition path mismatch");

    struct statvfs sbuf;

    auto ret = statvfs(CONFIG_AOS_DISK_MOUNT_POINT, &sbuf);
    zassert_equal(ret, 0, "Failed to get partition info: %s [%d]", strerror(ret), ret);

    const auto expectedSize = sbuf.f_bsize * sbuf.f_blocks;
    zassert_equal(nodeInfo.mPartitions[0].mTotalSize, expectedSize, "Partition total size mismatch");

    zassert_equal(nodeInfo.mPartitions[0].mTypes.Size(), 2, "Expected 2 partition types");
    zassert_equal(nodeInfo.mPartitions[0].mTypes[0], "services", "Partition type mismatch");
    zassert_equal(nodeInfo.mPartitions[0].mTypes[1], "layers", "Partition type mismatch");

    // test attributes
    zassert_equal(nodeInfo.mAttrs.Size(), 2, "Expected 2 attributes");
    zassert_equal(nodeInfo.mAttrs[0].mName, "AosComponents", "Attribute name mismatch");
    zassert_equal(nodeInfo.mAttrs[0].mValue, "iam,sm", "Attribute value mismatch");

    zassert_equal(nodeInfo.mAttrs[1].mName, "NodeRunners", "Attribute name mismatch");
    zassert_equal(nodeInfo.mAttrs[1].mValue, "xrun", "Attribute value mismatch");
}

ZTEST(nodeinfoprovider, test_node_id_is_autogenerated)
{
    auto err = aos::fs::Remove(cNodeIDFile);
    zassert_true(err.IsNone(), "Failed to remove node id file: %s", utils::ErrorToCStr(err));

    StubUUIDProvider                   uuidProvider;
    nodeinfoprovider::NodeInfoProvider provider;

    err = provider.Init(uuidProvider);
    zassert_true(err.IsNone(), "Failed to init node info provider: %s", utils::ErrorToCStr(err));

    aos::StaticString<aos::cNodeIDLen> nodeID;

    err = aos::fs::ReadFileToString(cNodeIDFile, nodeID);
    zassert_true(err.IsNone(), "Failed to read node id from file: %s", utils::ErrorToCStr(err));

    aos::NodeInfo nodeInfo;

    err = provider.GetNodeInfo(nodeInfo);
    zassert_true(err.IsNone(), "Failed to get node info: %s", utils::ErrorToCStr(err));

    zassert_false(nodeInfo.mNodeID.IsEmpty(), "Node ID is empty");
    zassert_equal(nodeInfo.mNodeID, nodeID, "Node ID mismatch");
}

ZTEST(nodeinfoprovider, test_set_get_node_info)
{
    StubUUIDProvider                   uuidProvider;
    nodeinfoprovider::NodeInfoProvider provider;

    auto err = provider.Init(uuidProvider);
    zassert_true(err.IsNone(), "Failed to init node info provider: %s", utils::ErrorToCStr(err));

    aos::NodeInfo nodeInfo;
    err = provider.GetNodeInfo(nodeInfo);

    zassert_true(err.IsNone(), "Failed to get node info: %s", utils::ErrorToCStr(err));
    zassert_equal(nodeInfo.mStatus.GetValue(), aos::NodeStatusEnum::eUnprovisioned, "Node status mismatch");

    err = provider.SetNodeStatus(aos::NodeStatus(aos::NodeStatusEnum::eProvisioned));
    zassert_true(err.IsNone(), "Set node status failed: %s", utils::ErrorToCStr(err));

    err = provider.GetNodeInfo(nodeInfo);
    zassert_true(err.IsNone(), "Get node status failed: %s", utils::ErrorToCStr(err));

    zassert_equal(nodeInfo.mStatus.GetValue(), aos::NodeStatusEnum::eProvisioned, "Node status mismatch");

    err = provider.SetNodeStatus(aos::NodeStatus(aos::NodeStatusEnum::ePaused));
    zassert_true(err.IsNone(), "Set node status failed: %s", utils::ErrorToCStr(err));

    err = provider.GetNodeInfo(nodeInfo);
    zassert_true(err.IsNone(), "Get node status failed: %s", utils::ErrorToCStr(err));

    zassert_equal(nodeInfo.mStatus.GetValue(), aos::NodeStatusEnum::ePaused, "Node status mismatch");
}

ZTEST(nodeinfoprovider, test_node_status_changed_observer)
{
    StubUUIDProvider                   uuidProvider;
    nodeinfoprovider::NodeInfoProvider provider;

    auto err = provider.Init(uuidProvider);
    zassert_true(err.IsNone(), "Failed to init node info provider: %s", utils::ErrorToCStr(err));

    aos::NodeInfo nodeInfo;
    err = provider.GetNodeInfo(nodeInfo);

    zassert_true(err.IsNone(), "Failed to get node info: %s", utils::ErrorToCStr(err));
    zassert_equal(nodeInfo.mStatus.GetValue(), aos::NodeStatusEnum::eUnprovisioned, "Node status mismatch");

    TestNodeStatusObserver observer1, observer2;

    err = provider.SubscribeNodeStatusChanged(observer1);
    zassert_true(err.IsNone(), "Failed to subscribe on node status changed: %s", utils::ErrorToCStr(err));

    err = provider.SubscribeNodeStatusChanged(observer2);
    zassert_true(err.IsNone(), "Failed to subscribe on node status changed: %s", utils::ErrorToCStr(err));

    err = provider.SetNodeStatus(aos::NodeStatus(aos::NodeStatusEnum::eProvisioned));
    zassert_true(err.IsNone(), "Set node status failed: %s", utils::ErrorToCStr(err));

    zassert_equal(observer1.mNodeStatus.GetValue(), aos::NodeStatusEnum::eProvisioned, "Node status mismatch");
    zassert_equal(observer1.mNodeID, nodeInfo.mNodeID, "Node id mismatch");

    zassert_equal(observer2.mNodeStatus.GetValue(), aos::NodeStatusEnum::eProvisioned, "Node status mismatch");
    zassert_equal(observer2.mNodeID, nodeInfo.mNodeID, "Node id mismatch");

    observer1.Reset();
    observer2.Reset();

    err = provider.SetNodeStatus(aos::NodeStatus(aos::NodeStatusEnum::ePaused));
    zassert_true(err.IsNone(), "Set node status failed: %s", utils::ErrorToCStr(err));

    zassert_equal(observer1.mNodeStatus.GetValue(), aos::NodeStatusEnum::ePaused, "Node status mismatch");
    zassert_equal(observer1.mNodeID, nodeInfo.mNodeID, "Node id mismatch");

    zassert_equal(observer2.mNodeStatus.GetValue(), aos::NodeStatusEnum::ePaused, "Node status mismatch");
    zassert_equal(observer2.mNodeID, nodeInfo.mNodeID, "Node id mismatch");

    observer1.Reset();
    observer2.Reset();

    // same node status change should not trigger the observer
    err = provider.SetNodeStatus(aos::NodeStatus(aos::NodeStatusEnum::ePaused));
    zassert_true(err.IsNone(), "Set node status failed: %s", utils::ErrorToCStr(err));

    zassert_false(observer1.mNotified, "Observer should not be notified");
    zassert_false(observer2.mNotified, "Observer should not be notified");

    observer1.Reset();
    observer2.Reset();

    // unsubscribe observer1
    err = provider.UnsubscribeNodeStatusChanged(observer1);
    zassert_true(err.IsNone(), "Failed to unsubscribe from node status changed event: %s", utils::ErrorToCStr(err));

    err = provider.SetNodeStatus(aos::NodeStatus(aos::NodeStatusEnum::eProvisioned));
    zassert_true(err.IsNone(), "Set node status failed: %s", utils::ErrorToCStr(err));

    // observer1 should not receive the event
    zassert_false(observer1.mNotified, "Observer should not be notified");

    // observer2 should receive the event
    zassert_true(observer2.mNotified, "Observer should be notified");
    zassert_equal(observer2.mNodeStatus.GetValue(), aos::NodeStatusEnum::eProvisioned, "Node status mismatch");
}

} // namespace aos::zephyr
```
