## CMakeLists.txt
```
# SPDX-License-Identifier: Apache-2.0

cmake_minimum_required(VERSION 3.20.0)

find_package(
    Zephyr
    COMPONENTS
    REQUIRED HINTS $ENV{ZEPHYR_BASE}
)

set(CMAKE_MODULE_PATH ${APPLICATION_SOURCE_DIR}/../../cmake)

project(provisioning_test)

# ######################################################################################################################
# Config
# ######################################################################################################################

set(AOS_CORE_CONFIG aoscoreconfig.hpp)

# ######################################################################################################################
# Definitions
# ######################################################################################################################

# Aos core configuration
add_definitions(-include ${AOS_CORE_CONFIG})

# ######################################################################################################################
# Includes
# ######################################################################################################################

target_include_directories(app PRIVATE ${APPLICATION_SOURCE_DIR}/../../../aos_core_lib_cpp/include)
target_include_directories(app PRIVATE ${APPLICATION_SOURCE_DIR}/../../src)
target_include_directories(app PRIVATE ${APPLICATION_SOURCE_DIR}/src)
target_include_directories(app PRIVATE ${CMAKE_CURRENT_BINARY_DIR})

# ######################################################################################################################
# Target
# ######################################################################################################################

target_sources(app PRIVATE ../../src/provisioning/provisioning.cpp src/main.cpp)
```

## Kconfig
```
# Copyright (C) 2023 Renesas Electronics Corporation.
# Copyright (C) 2023 EPAM Systems, Inc.
#
# SPDX-License-Identifier: Apache-2.0

mainmenu "Aos zephyr application"

config AOS_PROVISIONING_FILE
	string "Path to provisioning file."
	default "/tmp/aos/.provisioned"

source "Kconfig"
```

## prj.conf
```kconfig
# Enable C++

CONFIG_CPP=y
CONFIG_STD_CPP14=y
CONFIG_EXTERNAL_LIBCPP=y
CONFIG_CBPRINTF_FP_SUPPORT=y

# Enable test suit

CONFIG_ZTEST=y

# Enable debug for tests

CONFIG_DEBUG=y
CONFIG_NO_OPTIMIZATIONS=y

# Enable nanopb lib

CONFIG_NANOPB=y

# Enable tiny crypt lib

CONFIG_TINYCRYPT=y
CONFIG_TINYCRYPT_SHA256=y
```

## src/main.cpp
```c
/*
 * Copyright (C) 2024 Renesas Electronics Corporation.
 * Copyright (C) 2024 EPAM Systems, Inc.
 *
 * SPDX-License-Identifier: Apache-2.0
 */

#include <mutex>

#include <zephyr/tc_util.h>
#include <zephyr/ztest.h>

#include <aos/common/tools/fs.hpp>
#include <aos/common/tools/log.hpp>

#include "provisioning/provisioning.hpp"

/***********************************************************************************************************************
 * Types
 **********************************************************************************************************************/

struct provisioning_fixture {
    Provisioning mProvisioning;
};

/***********************************************************************************************************************
 * Setup
 **********************************************************************************************************************/

void TestLogCallback(const char* module, aos::LogLevel level, const aos::String& message)
{
    static std::mutex mutex;
    static auto       startTime = std::chrono::steady_clock::now();

    std::lock_guard<std::mutex> lock(mutex);

    auto now = std::chrono::duration<float>(std::chrono::steady_clock::now() - startTime).count();

    const char* levelStr = "unknown";

    switch (level.GetValue()) {
    case aos::LogLevelEnum::eDebug:
        levelStr = "dbg";
        break;

    case aos::LogLevelEnum::eInfo:
        levelStr = "inf";
        break;

    case aos::LogLevelEnum::eWarning:
        levelStr = "wrn";
        break;

    case aos::LogLevelEnum::eError:
        levelStr = "err";
        break;

    default:
        levelStr = "n/d";
        break;
    }

    printk("%0.3f [%s] %s\n", now, levelStr, message.CStr());
}

ZTEST_SUITE(
    provisioning, nullptr,
    []() -> void* {
        aos::Log::SetCallback(TestLogCallback);

        auto fixture = new provisioning_fixture;

        return fixture;
    },
    [](void* fixture) {
        auto err = aos::FS::RemoveAll(aos::FS::Dir(CONFIG_AOS_PROVISIONING_FILE));
        zassert_true(err.IsNone(), "Can't remove provisioning dir: %s", err.Message());
    },
    nullptr,
    [](void* fixture) {
        auto err = aos::FS::RemoveAll(aos::FS::Dir(CONFIG_AOS_PROVISIONING_FILE));
        zassert_true(err.IsNone(), "Can't remove provisioning dir: %s", err.Message());

        delete static_cast<provisioning_fixture*>(fixture);
    });

/***********************************************************************************************************************
 * Tests
 **********************************************************************************************************************/

ZTEST_F(provisioning, test_FinishProvisioning)
{
    auto err = fixture->mProvisioning.Init();
    zassert_true(err.IsNone(), "Can't initialize provisioning: %s", err.Message());

    zassert_false(fixture->mProvisioning.IsProvisioned());

    err = fixture->mProvisioning.FinishProvisioning();
    zassert_true(err.IsNone(), "Can't finish provisioning: %s", err.Message());

    zassert_true(fixture->mProvisioning.IsProvisioned());

    err = fixture->mProvisioning.Init();
    zassert_true(err.IsNone(), "Can't initialize provisioning: %s", err.Message());

    zassert_true(fixture->mProvisioning.IsProvisioned());
}
```
