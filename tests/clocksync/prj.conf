## CMakeLists.txt
```
# SPDX-License-Identifier: Apache-2.0

cmake_minimum_required(VERSION 3.20.0)
find_package(Zephyr REQUIRED HINTS $ENV{ZEPHYR_BASE})

project(clocksync_test)

# ######################################################################################################################
# Config
# ######################################################################################################################

set(AOS_CORE_CONFIG aoscoreconfig.hpp)
set(aoscore_source_dir "${CMAKE_CURRENT_SOURCE_DIR}/../../../aos_core_lib_cpp")

# ######################################################################################################################
# Definitions
# ######################################################################################################################

# Aos core configuration
add_definitions(-include ${AOS_CORE_CONFIG})

# ######################################################################################################################
# Includes
# ######################################################################################################################

zephyr_include_directories(${APPLICATION_SOURCE_DIR}/..)
zephyr_include_directories(${APPLICATION_SOURCE_DIR}/../../src)
zephyr_include_directories(${APPLICATION_SOURCE_DIR}/../../../aos_core_lib_cpp/include)
zephyr_include_directories(${CMAKE_CURRENT_BINARY_DIR})

# ######################################################################################################################
# Target
# ######################################################################################################################

target_sources(
    app PRIVATE src/main.cpp ../utils/log.cpp ../../src/utils/utils.cpp ../../src/clocksync/clocksync.cpp
                ${aoscore_source_dir}/src/common/tools/time.cpp
)
```

## Kconfig
```
# Copyright (C) 2023 Renesas Electronics Corporation.
# Copyright (C) 2023 EPAM Systems, Inc.
#
# SPDX-License-Identifier: Apache-2.0

mainmenu "Aos zephyr application"

config AOS_CLOCK_SYNC_SEND_PERIOD_SEC
	int "Send clock sync period in seconds"
	default 1

config AOS_CLOCK_SYNC_TIMEOUT_SEC
	int "Clock becomes unsynced if there is no clock sync update during this period."
	default 2

config AOS_CLOCK_SYNC_MAX_DIFF_MSEC
	int "Maximum allowed difference between source and current time."
	default 10000

source "Kconfig"
```

## prj.conf
```kconfig
# Enable C++
CONFIG_CPP=y
CONFIG_STD_CPP14=y
CONFIG_EXTERNAL_LIBCPP=y
CONFIG_CBPRINTF_FP_SUPPORT=y

# Enable test suit
CONFIG_ZTEST=y
```

## src/main.cpp
```c
/*
 * Copyright (C) 2024 Renesas Electronics Corporation.
 * Copyright (C) 2024 EPAM Systems, Inc.
 *
 * SPDX-License-Identifier: Apache-2.0
 */

#include <mutex>

#include <zephyr/tc_util.h>
#include <zephyr/ztest.h>

#include "clocksync/clocksync.hpp"

#include "stubs/senderstub.hpp"
#include "stubs/subscriberstub.hpp"
#include "utils/log.hpp"
#include "utils/utils.hpp"

using namespace aos::zephyr;

/***********************************************************************************************************************
 * Consts
 **********************************************************************************************************************/

static constexpr auto cWaitTimeout = std::chrono::seconds {5};

/***********************************************************************************************************************
 * Types
 **********************************************************************************************************************/

struct clocksync_fixture {
    SenderStub           mSender;
    SubscriberStub       mSubscriber;
    clocksync::ClockSync mClockSync;
};

/***********************************************************************************************************************
 * Setup
 **********************************************************************************************************************/

ZTEST_SUITE(
    clocksync, nullptr,
    []() -> void* {
        aos::Log::SetCallback(TestLogCallback);

        auto fixture = new clocksync_fixture;

        auto err = fixture->mClockSync.Init(fixture->mSender);
        zassert_true(err.IsNone(), "Can't initialize clock sync: %s", utils::ErrorToCStr(err));

        err = fixture->mClockSync.Subscribe(fixture->mSubscriber);
        zassert_true(err.IsNone(), "Can't subscribe for clock sync: %s", utils::ErrorToCStr(err));

        return fixture;
    },
    [](void* fixture) {
        auto f = static_cast<clocksync_fixture*>(fixture);

        f->mSender.Clear();
    },
    nullptr, [](void* fixture) { delete static_cast<clocksync_fixture*>(fixture); });

/***********************************************************************************************************************
 * Tests
 **********************************************************************************************************************/

ZTEST_F(clocksync, test_Synced)
{
    auto err = fixture->mClockSync.Start();
    zassert_true(err.IsNone(), "Error starting clock sync: %s", utils::ErrorToCStr(err));

    err = fixture->mSender.WaitEvent(cWaitTimeout);
    zassert_true(err.IsNone(), "Error waiting sync request: %s", utils::ErrorToCStr(err));

    zassert_true(fixture->mSender.IsSyncRequest());

    err = fixture->mClockSync.Sync(aos::Time::Now());
    zassert_true(err.IsNone(), "Error sync clock: %s", utils::ErrorToCStr(err));

    err = fixture->mSubscriber.WaitEvent(cWaitTimeout);
    zassert_true(err.IsNone(), "Error waiting clock synced: %s", utils::ErrorToCStr(err));

    zassert_true(fixture->mSubscriber.IsSynced());
}

ZTEST_F(clocksync, test_Unsynced)
{
    auto err = fixture->mSubscriber.WaitEvent(cWaitTimeout);
    zassert_true(err.IsNone(), "Error waiting clock unsynced: %s", utils::ErrorToCStr(err));

    zassert_false(fixture->mSubscriber.IsSynced());

    err = fixture->mSender.WaitEvent(cWaitTimeout);
    zassert_true(err.IsNone(), "Error waiting sync request: %s", utils::ErrorToCStr(err));

    zassert_true(fixture->mSender.IsSyncRequest());
}
```
