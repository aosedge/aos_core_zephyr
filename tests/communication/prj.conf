## CMakeLists.txt
```
# SPDX-License-Identifier: Apache-2.0

cmake_minimum_required(VERSION 3.20.0)

find_package(
    Zephyr
    COMPONENTS
    REQUIRED HINTS $ENV{ZEPHYR_BASE}
)

set(CMAKE_MODULE_PATH ${APPLICATION_SOURCE_DIR}/../../cmake)

project(communication_test)

# ######################################################################################################################
# Config
# ######################################################################################################################

set(aoscore_config aoscoreconfig.hpp)
set(aoscore_source_dir "${CMAKE_CURRENT_SOURCE_DIR}/../../../aos_core_lib_cpp")
set(cert_dir ${CMAKE_CURRENT_BINARY_DIR}/certificates)

# ######################################################################################################################
# Definitions
# ######################################################################################################################

# Aos core configuration
add_definitions(-include ${aoscore_config})
# Certificate dir
add_definitions(-DCERT_DIR="${cert_dir}")
# Root CA cart path
add_definitions(-DCONFIG_AOS_ROOT_CA_PATH="${cert_dir}/ca.pem")

# ######################################################################################################################
# Includes
# ######################################################################################################################

file(COPY ${APPLICATION_SOURCE_DIR}/../../../aos_core_api/aosprotocol/aosprotocol.h
     DESTINATION ${CMAKE_CURRENT_BINARY_DIR}
)

zephyr_include_directories(${aoscore_source_dir}/include)
zephyr_include_directories(${APPLICATION_SOURCE_DIR}/..)
zephyr_include_directories(${APPLICATION_SOURCE_DIR}/../../src)
zephyr_include_directories(${APPLICATION_SOURCE_DIR}/src)
zephyr_include_directories(${CMAKE_CURRENT_BINARY_DIR})

# ######################################################################################################################
# Certificates
# ######################################################################################################################

file(MAKE_DIRECTORY ${cert_dir})

foreach(cert_type IN ITEMS "ca" "server" "client")
    execute_process(COMMAND openssl genrsa -out ${cert_dir}/${cert_type}.key 2048)

    execute_process(
        COMMAND openssl req -new -key ${cert_dir}/${cert_type}.key -out ${cert_dir}/${cert_type}.csr -subj
                "/C=XX/ST=State/L=City/O=Organization/OU=Unit/CN=${TYPE}" COMMAND_ERROR_IS_FATAL ANY
    )
endforeach()

execute_process(
    COMMAND openssl x509 -req -days 365 -in ${cert_dir}/ca.csr -signkey ${cert_dir}/ca.key -out ${cert_dir}/ca.pem
            COMMAND_ERROR_IS_FATAL ANY
)

foreach(cert_type IN ITEMS "server" "client")
    execute_process(
        COMMAND openssl x509 -req -days 365 -in ${cert_dir}/${cert_type}.csr -CA ${cert_dir}/ca.pem -CAkey
                ${cert_dir}/ca.key -CAcreateserial -out ${cert_dir}/${cert_type}.cer COMMAND_ERROR_IS_FATAL ANY
    )
endforeach()

# ######################################################################################################################
# mbedTLS
# ######################################################################################################################

# Enable AESNI for posix 32bit
if(${CONFIG_BOARD_NATIVE_POSIX})
    target_compile_options(mbedTLS INTERFACE -mpclmul -msse2 -maes)
endif()

# WA to have get time on zephyr
target_compile_definitions_ifndef(CONFIG_NATIVE_APPLICATION mbedTLS INTERFACE _POSIX_VERSION=200809L)

# Add Aos psa driver

set(mbedtls_source_dir "${APPLICATION_SOURCE_DIR}/../../../modules/crypto/mbedtls")
set(aoscore_source_dir "${APPLICATION_SOURCE_DIR}/../../../aos_core_lib_cpp")

set_source_files_properties(
    ${mbedtls_source_dir}/library/psa_crypto_driver_wrappers_no_static.c ${mbedtls_source_dir}/library/psa_crypto.c
    TARGET_DIRECTORY mbedTLS PROPERTIES HEADER_FILE_ONLY ON
)

target_include_directories(mbedTLSCrypto PRIVATE ${mbedtls_source_dir}/library)

target_sources(
    mbedTLSCrypto
    PRIVATE ${aoscore_source_dir}/src/common/crypto/mbedtls/drivers/psa_crypto_driver_wrappers_no_static.c
            ${aoscore_source_dir}/src/common/crypto/mbedtls/drivers/psa_crypto.c
            ${aoscore_source_dir}/src/common/crypto/mbedtls/driverwrapper.cpp ${mbedtls_source_dir}/library/pk_ecc.c
)

target_sources(mbedTLSX509 PRIVATE ${mbedtls_source_dir}/library/x509write.c)

# ######################################################################################################################
# Target
# ######################################################################################################################

target_sources(
    app
    PRIVATE ../../src/communication/tlschannel.cpp
            ../../src/rootca/rootca.S
            ../../src/communication/channel.cpp
            ../../src/communication/channelmanager.cpp
            ../../src/utils/checksum.cpp
            ../utils/log.cpp
            src/channelmanager.cpp
            src/tlschannel.cpp
            ${aoscore_source_dir}/src/common/tools/fs.cpp
            ${aoscore_source_dir}/src/common/tools/time.cpp
)
```

## Kconfig
```
# Copyright (C) 2023 Renesas Electronics Corporation.
# Copyright (C) 2023 EPAM Systems, Inc.
#
# SPDX-License-Identifier: Apache-2.0

mainmenu "Aos zephyr application"

config AOS_DOMD_ID
	int "DomD id"
	default 1

config AOS_NODE_ID
	string "Node id"
	default "NODE_0"

config AOS_NODE_TYPE
	string "Node type"
	default "NODE_TYPE"

config AOS_VCHAN_TX_PATH
	string "Path to the SM vchan"
	default "/vchan/tx"

config AOS_VCHAN_RX_PATH
	string "Path to the SM vchan"
	default "/vchan/rx"

config AOS_RUNTIME_DIR
	string "Aos runtime dir"
	default "/aos/runtime"

config AOS_SERVICES_DIR
	string "Aos services dir"
	default "/aos/services"

config AOS_UNIT_CONFIG_FILE
	string "Node configuration file path"
	default "/aos/unit_config.cfg"

config AOS_CLOCK_SYNC_SEND_PERIOD_SEC
	int "Send clock sync period in seconds"
	default 1

config AOS_CLOCK_SYNC_TIMEOUT_SEC
	int "Clock becomes unsynced if there is no clock sync update during this period."
	default 1

config AOS_CLOCK_SYNC_MAX_DIFF_MSEC
	int "Maximum allowed difference between source and current time."
	default 10000

source "Kconfig"
```

## prj.conf
```kconfig
# Enable C++

CONFIG_CPP=y
CONFIG_STD_CPP17=y
CONFIG_EXTERNAL_LIBCPP=y
CONFIG_CBPRINTF_FP_SUPPORT=y

# Enable test suit

CONFIG_ZTEST=y

# Enable debug for tests

CONFIG_DEBUG=y
CONFIG_NO_OPTIMIZATIONS=y

# Enable mbedtls

CONFIG_MBEDTLS=y
CONFIG_MBEDTLS_BUILTIN=y
CONFIG_MBEDTLS_ZEPHYR_ENTROPY=y
CONFIG_MBEDTLS_USER_CONFIG_ENABLE=y
CONFIG_MBEDTLS_USER_CONFIG_FILE="testmbedtlsconfig.h"

CONFIG_MBEDTLS_CIPHER_CCM_ENABLED=y
CONFIG_MBEDTLS_ECDH_C=y
CONFIG_MBEDTLS_ECDSA_C=y
CONFIG_MBEDTLS_ECP_C=y
CONFIG_MBEDTLS_ECP_DP_SECP256R1_ENABLED=y
CONFIG_MBEDTLS_ECP_DP_SECP384R1_ENABLED=y
CONFIG_MBEDTLS_KEY_EXCHANGE_ECDHE_ECDSA_ENABLED=y
CONFIG_MBEDTLS_KEY_EXCHANGE_RSA_ENABLED=y
CONFIG_MBEDTLS_PEM_CERTIFICATE_FORMAT=y
CONFIG_MBEDTLS_PK_WRITE_C=y
CONFIG_MBEDTLS_PSA_CRYPTO_C=y
CONFIG_MBEDTLS_SSL_MAX_CONTENT_LEN=16384
CONFIG_MBEDTLS_TLS_VERSION_1_2=y

# Enable entropy generator

CONFIG_ENTROPY_GENERATOR=y
CONFIG_TEST_RANDOM_GENERATOR=y
```

## src/channelmanager.cpp
```c
/*
 * Copyright (C) 2023 Renesas Electronics Corporation.
 * Copyright (C) 2023 EPAM Systems, Inc.
 *
 * SPDX-License-Identifier: Apache-2.0
 */

#include <chrono>
#include <mutex>
#include <thread>

#include <zephyr/kernel.h>
#include <zephyr/tc_util.h>
#include <zephyr/ztest.h>

#include <aos/common/tools/log.hpp>

#include "communication/channelmanager.hpp"
#include "utils/checksum.hpp"
#include "utils/log.hpp"

#include "stubs/transportstub.hpp"

/***********************************************************************************************************************
 * Static
 **********************************************************************************************************************/

static aos::RetWithError<AosProtocolHeader> PrepareHeader(uint32_t port, const aos::Array<uint8_t>& data)
{
    AosProtocolHeader header;
    header.mPort     = port;
    header.mDataSize = data.Size();

    auto ret = aos::zephyr::utils::CalculateSha256(data);
    if (!ret.mError.IsNone()) {
        return {header, AOS_ERROR_WRAP(ret.mError)};
    }

    aos::Array<uint8_t>(reinterpret_cast<uint8_t*>(header.mCheckSum), aos::cSHA256Size) = ret.mValue;

    return header;
}

/***********************************************************************************************************************
 * Setup
 **********************************************************************************************************************/

ZTEST_SUITE(channelmanager, nullptr, nullptr, nullptr, nullptr, nullptr);

/***********************************************************************************************************************
 * Tests
 **********************************************************************************************************************/

ZTEST(channelmanager, test_message_exchange)
{
    aos::Log::SetCallback(TestLogCallback);

    aos::zephyr::communication::Pipe           pipe1;
    aos::zephyr::communication::Pipe           pipe2;
    aos::zephyr::communication::TransportStub  transport(pipe1, pipe2);
    aos::zephyr::communication::ChannelManager channelManager;

    auto err = channelManager.Init(transport);
    zassert_true(err.IsNone(), "Channel manager initialization failed");

    err = channelManager.Start();
    zassert_true(err.IsNone(), "Channel manager start failed");

    auto ret = channelManager.CreateChannel(8080);
    zassert_true(ret.mError.IsNone(), "Channel creation failed", ret.mError.Message());
    zassert_true(ret.mValue != nullptr, "Channel creation failed");

    const char* msg = "Test1";
    ret.mValue->Write(msg, strlen(msg));

    AosProtocolHeader header;
    int               bytesRead = pipe2.Read(reinterpret_cast<uint8_t*>(&header), sizeof(AosProtocolHeader));
    zassert_true(bytesRead == sizeof(AosProtocolHeader), "Failed to read header");
    zassert_equal(header.mPort, 8080, "Port mismatch");

    char buffer[100] {};
    bytesRead         = pipe2.Read(reinterpret_cast<uint8_t*>(buffer), header.mDataSize);
    buffer[bytesRead] = '\0';
    zassert_equal(strcmp(buffer, msg), 0, "Message read from transport does not match");

    char response[] = "Test2!";
    auto headerRet  = PrepareHeader(8080, aos::Array<uint8_t>(reinterpret_cast<uint8_t*>(response), strlen(response)));
    zassert_true(headerRet.mError.IsNone(), "Failed to prepare header");

    pipe1.Write(reinterpret_cast<uint8_t*>(&headerRet.mValue), sizeof(AosProtocolHeader));
    pipe1.Write(reinterpret_cast<uint8_t*>(response), strlen(response));

    memset(buffer, 0, sizeof(buffer));

    bytesRead         = ret.mValue->Read(buffer, strlen(response));
    buffer[bytesRead] = '\0';
    zassert_equal(strcmp(buffer, response), 0, "Message read from transport does not match");

    pipe1.Close();
    pipe2.Close();

    channelManager.Stop();
}

ZTEST(channelmanager, test_read_message)
{
    aos::Log::SetCallback(TestLogCallback);

    aos::zephyr::communication::Pipe           pipe1;
    aos::zephyr::communication::Pipe           pipe2;
    aos::zephyr::communication::TransportStub  transport(pipe1, pipe2);
    aos::zephyr::communication::ChannelManager channelManager;

    auto err = channelManager.Init(transport);
    zassert_true(err.IsNone(), "Channel manager initialization failed");

    err = channelManager.Start();
    zassert_true(err.IsNone(), "Channel manager start failed");

    auto ret = channelManager.CreateChannel(8080);
    zassert_true(ret.mError.IsNone(), "Channel creation failed", ret.mError.Message());
    zassert_true(ret.mValue != nullptr, "Channel creation failed");

    char response[] = "Test!";
    auto headerRet  = PrepareHeader(8080, aos::Array<uint8_t>(reinterpret_cast<uint8_t*>(response), strlen(response)));
    zassert_true(headerRet.mError.IsNone(), "Failed to prepare header");

    std::thread tRead([&]() {
        char buffer[100] {};
        auto bytesRead = ret.mValue->Read(buffer, strlen(response));

        buffer[bytesRead] = '\0';
        zassert_equal(strcmp(buffer, response), 0, "Message read from transport does not match");
    });

    pipe1.Write(reinterpret_cast<uint8_t*>(&headerRet.mValue), sizeof(AosProtocolHeader));
    pipe1.Write(reinterpret_cast<uint8_t*>(response), strlen(response));

    tRead.join();

    pipe1.Close();
    pipe2.Close();

    channelManager.Stop();
}

ZTEST(channelmanager, test_read_message_in_chunks)
{
    aos::Log::SetCallback(TestLogCallback);

    aos::zephyr::communication::Pipe           pipe1;
    aos::zephyr::communication::Pipe           pipe2;
    aos::zephyr::communication::TransportStub  transport(pipe1, pipe2);
    aos::zephyr::communication::ChannelManager channelManager;

    auto err = channelManager.Init(transport);
    zassert_true(err.IsNone(), "Channel manager initialization failed");

    err = channelManager.Start();
    zassert_true(err.IsNone(), "Channel manager start failed");

    auto ret = channelManager.CreateChannel(8080);
    zassert_true(ret.mError.IsNone(), "Channel creation failed", ret.mError.Message());
    zassert_true(ret.mValue != nullptr, "Channel creation failed");

    char response[] = "Test";
    auto headerRet  = PrepareHeader(8080, aos::Array<uint8_t>(reinterpret_cast<uint8_t*>(response), strlen(response)));
    zassert_true(headerRet.mError.IsNone(), "Failed to prepare header");

    std::thread tRead([&]() {
        char resultBuffer[100] {};
        char buffer[100] {};
        auto bytesRead = ret.mValue->Read(buffer, strlen(response) / 2);
        memcpy(resultBuffer, buffer, bytesRead);

        memset(buffer, 0, sizeof(buffer));

        bytesRead = ret.mValue->Read(buffer, strlen(response) / 2);
        memcpy(resultBuffer + strlen(response) / 2, buffer, bytesRead);

        resultBuffer[strlen(response)] = '\0';

        zassert_equal(strcmp(resultBuffer, response), 0, "Message read from transport does not match");
    });

    pipe1.Write(reinterpret_cast<uint8_t*>(&headerRet.mValue), sizeof(AosProtocolHeader));
    pipe1.Write(reinterpret_cast<uint8_t*>(response), strlen(response));

    tRead.join();

    pipe1.Close();
    pipe2.Close();

    channelManager.Stop();
}
```

## src/iamserver.cpp
```c
/*
 * Copyright (C) 2023 Renesas Electronics Corporation.
 * Copyright (C) 2023 EPAM Systems, Inc.
 *
 * SPDX-License-Identifier: Apache-2.0
 */

#include <zephyr/tc_util.h>
#include <zephyr/ztest.h>

#include "communication/communication.hpp"

#include "stubs/certhandlerstub.hpp"
#include "stubs/clocksyncstub.hpp"
#include "stubs/commchannelstub.hpp"
#include "stubs/connectionsubscriberstub.hpp"
#include "stubs/downloaderstub.hpp"
#include "stubs/launcherstub.hpp"
#include "stubs/monitoringstub.hpp"
#include "stubs/provisioningstub.hpp"
#include "stubs/resourcemanagerstub.hpp"
#include "utils.hpp"

/***********************************************************************************************************************
 * Types
 **********************************************************************************************************************/

struct iamserver_fixture {
    CommChannelStub     mOpenChannel;
    CommChannelStub     mSecureChannel;
    LauncherStub        mLauncher;
    CertHandlerStub     mCertHandler;
    ResourceManagerStub mResourceManager;
    ResourceMonitorStub mResourceMonitor;
    DownloaderStub      mDownloader;
    ClockSyncStub       mClockSync;
    ProvisioningStub    mProvisioning;
    Communication       mCommunication;
};

/***********************************************************************************************************************
 * Static
 **********************************************************************************************************************/

static std::string FullMethodName(const std::string& serviceName, const std::string& methodName)
{
    return "/" + serviceName + "/" + methodName;
}

/***********************************************************************************************************************
 * Setup
 **********************************************************************************************************************/

ZTEST_SUITE(
    iamserver, nullptr,
    []() -> void* {
        aos::Log::SetCallback(TestLogCallback);

        auto fixture = new iamserver_fixture;

        auto err = fixture->mCommunication.Init(fixture->mOpenChannel, fixture->mSecureChannel, fixture->mLauncher,
            fixture->mCertHandler, fixture->mResourceManager, fixture->mResourceMonitor, fixture->mDownloader,
            fixture->mClockSync, fixture->mProvisioning);
        zassert_true(err.IsNone(), "Can't initialize communication: %s", err.Message());

        fixture->mCommunication.ClockSynced();

        return fixture;
    },
    [](void* fixture) {
        auto f = static_cast<iamserver_fixture*>(fixture);

        f->mOpenChannel.Clear();
        f->mSecureChannel.Clear();
        f->mLauncher.Clear();
        f->mCertHandler.Clear();
        f->mResourceManager.Clear();
        f->mResourceMonitor.Clear();
        f->mDownloader.Clear();
        f->mClockSync.Clear();
        f->mProvisioning.SetProvisioned(false);
    },
    nullptr, [](void* fixture) { delete static_cast<iamserver_fixture*>(fixture); });

/***********************************************************************************************************************
 * Tests
 **********************************************************************************************************************/

ZTEST_F(iamserver, test_GetAllNodeIDs)
{
    auto err = SendPBMessage(fixture->mSecureChannel, AOS_VCHAN_IAM,
        FullMethodName(IAMServer::cServiceProvisioning, IAMServer::cMethodGetAllNodeIDs), 0);
    zassert_true(err.IsNone(), "Error sending message: %s", err.Message());

    iamanager_v4_NodesID nodesID;

    err = ReceivePBMessage(
        fixture->mSecureChannel, AOS_VCHAN_IAM, "", 0, &iamanager_v4_NodesID_msg, &nodesID, iamanager_v4_NodesID_size);
    zassert_true(err.IsNone(), "Error receiving message: %s", err.Message());

    zassert_equal(nodesID.ids_count, 1);
    zassert_equal(strcmp(nodesID.ids[0], CONFIG_AOS_NODE_ID), 0);
}

ZTEST_F(iamserver, test_GetCertTypes)
{
    std::vector<std::string> certTypes {"certType1", "certType2", "certType3"};

    fixture->mCertHandler.SetCertTypes(certTypes);

    auto err = SendPBMessage(fixture->mSecureChannel, AOS_VCHAN_IAM,
        FullMethodName(IAMServer::cServiceProvisioning, IAMServer::cMethodGetCertTypes), 0);
    zassert_true(err.IsNone(), "Error sending message: %s", err.Message());

    iamanager_v4_CertTypes pbCertTypes;

    err = ReceivePBMessage(fixture->mSecureChannel, AOS_VCHAN_IAM, "", 0, &iamanager_v4_CertTypes_msg, &pbCertTypes,
        iamanager_v4_CertTypes_size);
    zassert_true(err.IsNone(), "Error receiving message: %s", err.Message());

    zassert_equal(pbCertTypes.types_count, certTypes.size());

    for (size_t i = 0; i < certTypes.size(); i++) {
        zassert_equal(strcmp(certTypes[i].c_str(), pbCertTypes.types[i]), 0);
    }
}

ZTEST_F(iamserver, test_SetOwner)
{
    iamanager_v4_SetOwnerRequest pbSetOwner {CONFIG_AOS_NODE_ID, "certType", "password"};

    auto err = SendPBMessage(fixture->mSecureChannel, AOS_VCHAN_IAM,
        FullMethodName(IAMServer::cServiceProvisioning, IAMServer::cMethodSetOwner), 42,
        &iamanager_v4_SetOwnerRequest_msg, &pbSetOwner, iamanager_v4_SetOwnerRequest_size);
    zassert_true(err.IsNone(), "Error sending message: %s", err.Message());

    err = ReceivePBMessage(fixture->mSecureChannel, AOS_VCHAN_IAM, "", 42);
    zassert_true(err.IsNone(), "Error receiving message: %s", err.Message());

    zassert_equal(fixture->mCertHandler.GetCertType(), pbSetOwner.type);
    zassert_equal(fixture->mCertHandler.GetPassword(), pbSetOwner.password);
}

ZTEST_F(iamserver, test_Clear)
{
    iamanager_v4_ClearRequest pbClear {CONFIG_AOS_NODE_ID, "certType"};

    auto err = SendPBMessage(fixture->mSecureChannel, AOS_VCHAN_IAM,
        FullMethodName(IAMServer::cServiceProvisioning, IAMServer::cMethodClear), 43, &iamanager_v4_ClearRequest_msg,
        &pbClear, iamanager_v4_ClearRequest_size);
    zassert_true(err.IsNone(), "Error sending message: %s", err.Message());

    err = ReceivePBMessage(fixture->mSecureChannel, AOS_VCHAN_IAM, "", 43);
    zassert_true(err.IsNone(), "Error receiving message: %s", err.Message());

    zassert_true(fixture->mCertHandler.GetClear());
}

ZTEST_F(iamserver, test_DiskEncryption)
{
    iamanager_v4_EncryptDiskRequest pbEncryptDisk {CONFIG_AOS_NODE_ID, "password"};

    auto err = SendPBMessage(fixture->mSecureChannel, AOS_VCHAN_IAM,
        FullMethodName(IAMServer::cServiceProvisioning, IAMServer::cMethodEncryptDisk), 44,
        &iamanager_v4_EncryptDiskRequest_msg, &pbEncryptDisk, iamanager_v4_EncryptDiskRequest_size);
    zassert_true(err.IsNone(), "Error sending message: %s", err.Message());

    err = ReceivePBMessage(fixture->mSecureChannel, AOS_VCHAN_IAM, "", 44);
    zassert_true(err.Is(aos::ErrorEnum::eNotSupported), "Wrong error received: %s", err.Message());
}

ZTEST_F(iamserver, test_CreateKey)
{
    iamanager_v4_CreateKeyRequest pbCreateKeyRequest {CONFIG_AOS_NODE_ID, "subject", "type", "password"};

    const auto csr = "CSR payload";

    fixture->mCertHandler.SetCSR(csr);

    auto err = SendPBMessage(fixture->mSecureChannel, AOS_VCHAN_IAM,
        FullMethodName(IAMServer::cServiceCertificate, IAMServer::cMethodCreateKey), 46,
        &iamanager_v4_CreateKeyRequest_msg, &pbCreateKeyRequest, iamanager_v4_CreateKeyRequest_size);
    zassert_true(err.IsNone(), "Error sending message: %s", err.Message());

    iamanager_v4_CreateKeyResponse pbCreateKeyResponse iamanager_v4_CreateKeyResponse_init_default;

    err = ReceivePBMessage(fixture->mSecureChannel, AOS_VCHAN_IAM, "", 46, &iamanager_v4_CreateKeyResponse_msg,
        &pbCreateKeyResponse, iamanager_v4_CreateKeyResponse_size);
    zassert_true(err.IsNone(), "Error receiving message: %s", err.Message());

    zassert_equal(strcmp(pbCreateKeyResponse.node_id, pbCreateKeyRequest.node_id), 0);
    zassert_equal(strcmp(pbCreateKeyResponse.type, pbCreateKeyRequest.type), 0);
    zassert_equal(strcmp(pbCreateKeyResponse.csr, csr), 0);
    zassert_equal(fixture->mCertHandler.GetSubject(), pbCreateKeyRequest.subject);
}

ZTEST_F(iamserver, test_ApplyCert)
{
    iamanager_v4_ApplyCertRequest pbApplyCertRequest {CONFIG_AOS_NODE_ID, "type", "Certificate payload"};

    const uint8_t serial[] = {0, 1, 2, 3, 4, 5, 6, 7, 8, 9};

    aos::iam::certhandler::CertInfo certInfo {{}, aos::Array<uint8_t>(serial, sizeof(serial)), "certificate URL"};

    fixture->mCertHandler.SetCertInfo(certInfo);

    auto err = SendPBMessage(fixture->mSecureChannel, AOS_VCHAN_IAM,
        FullMethodName(IAMServer::cServiceCertificate, IAMServer::cMethodApplyCert), 47,
        &iamanager_v4_ApplyCertRequest_msg, &pbApplyCertRequest, iamanager_v4_ApplyCertRequest_size);
    zassert_true(err.IsNone(), "Error sending message: %s", err.Message());

    iamanager_v4_ApplyCertResponse pbApplyCertResponse iamanager_v4_ApplyCertResponse_init_default;

    err = ReceivePBMessage(fixture->mSecureChannel, AOS_VCHAN_IAM, "", 47, &iamanager_v4_ApplyCertResponse_msg,
        &pbApplyCertResponse, iamanager_v4_ApplyCertResponse_size);
    zassert_true(err.IsNone(), "Error receiving message: %s", err.Message());

    aos::StaticString<aos::crypto::cSerialNumStrLen> strSerial;

    err = strSerial.ByteArrayToHex(aos::Array<uint8_t>(serial, sizeof(serial)));
    zassert_true(err.IsNone(), "Can't convert serial: %s", err.Message());

    zassert_equal(strcmp(pbApplyCertResponse.node_id, pbApplyCertRequest.node_id), 0);
    zassert_equal(strcmp(pbApplyCertResponse.type, pbApplyCertRequest.type), 0);
    zassert_equal(fixture->mCertHandler.GetCertificate(), pbApplyCertRequest.cert);
    zassert_equal(certInfo.mCertURL, pbApplyCertResponse.cert_url);
    zassert_equal(strSerial, pbApplyCertResponse.serial);
}

// Tests are executed by alphabetical order.
// This test should be run at the end as it removes provisioning PB services from open channel.
ZTEST_F(iamserver, test_ZZZ_FinishProvisioning)
{

    auto err = SendPBMessage(fixture->mSecureChannel, AOS_VCHAN_IAM,
        FullMethodName(IAMServer::cServiceProvisioning, IAMServer::cMethodFinishProvisioning), 45);
    zassert_true(err.IsNone(), "Error sending message: %s", err.Message());

    err = ReceivePBMessage(fixture->mSecureChannel, AOS_VCHAN_IAM, "", 45);
    zassert_true(err.IsNone(), "Error receiving message: %s", err.Message());
}
```

## src/mbedtlsconfig.h
```c
/*
 * Copyright (C) 2024 Renesas Electronics Corporation.
 * Copyright (C) 2024 EPAM Systems, Inc.
 *
 * SPDX-License-Identifier: Apache-2.0
 */

#ifndef AOSMBEDTLSCONFIG_H_
#define AOSMBEDTLSCONFIG_H_

#define MBEDTLS_NO_PLATFORM_ENTROPY
#define MBEDTLS_ENTROPY_HARDWARE_ALT
#define MBEDTLS_NET_C

#include "../../../aos_core_lib_cpp/include/aos/common/crypto/mbedtls/mbedtls_config.h"

#endif
```

## src/testmbedtlsconfig.h
```c
/*
 * Copyright (C) 2024 Renesas Electronics Corporation.
 * Copyright (C) 2024 EPAM Systems, Inc.
 *
 * SPDX-License-Identifier: Apache-2.0
 */

#ifndef TESTMBEDTLSCONFIG_H_
#define TESTMBEDTLSCONFIG_H_

#define MBEDTLS_PEM_WRITE_C
#define MBEDTLS_PK_HAVE_ECC_KEYS
#define MBEDTLS_PSA_CRYPTO_BUILTIN_KEYS
#define MBEDTLS_TEST_SW_INET_PTON
#define MBEDTLS_X509_CREATE_C
#define MBEDTLS_X509_CRT_WRITE_C
#define MBEDTLS_X509_CSR_PARSE_C
#define MBEDTLS_X509_CSR_WRITE_C
#define PSA_CRYPTO_DRIVER_AOS
#define MBEDTLS_NET_C

#endif
```

## src/tlschannel.cpp
```c
/*
 * Copyright (C) 2024 Renesas Electronics Corporation.
 * Copyright (C) 2024 EPAM Systems, Inc.
 *
 * SPDX-License-Identifier: Apache-2.0
 */

#include <future>

#include <zephyr/tc_util.h>
#include <zephyr/ztest.h>

#include <mbedtls/ctr_drbg.h>
#include <mbedtls/debug.h>
#include <mbedtls/entropy.h>
#include <mbedtls/net_sockets.h>
#include <mbedtls/ssl.h>
#include <psa/crypto.h>

#include <aos/common/tools/fs.hpp>

#include "communication/channel.hpp"
#include "communication/tlschannel.hpp"

#include "stubs/certhandlerstub.hpp"
#include "stubs/certloaderstub.hpp"
#include "stubs/rsaprivatekey.hpp"

using namespace aos::zephyr;

/***********************************************************************************************************************
 * Types
 **********************************************************************************************************************/

class ClientChannel : public communication::ChannelItf {
public:
    ClientChannel() { mbedtls_net_init(&mServerFd); }
    ~ClientChannel() { mbedtls_net_free(&mServerFd); }

    aos::Error SetTLSConfig(const aos::String& certType) { return aos::ErrorEnum::eNone; }

    aos::Error Connect() override
    {
        return mbedtls_net_connect(&mServerFd, "localhost", "4433", MBEDTLS_NET_PROTO_TCP);
    }

    aos::Error Close() override { return aos::ErrorEnum::eNone; }

    bool IsConnected() const override { return true; }

    int Read(void* data, size_t size) override
    {
        return mbedtls_net_recv(&mServerFd, static_cast<unsigned char*>(data), size);
    }

    int Write(const void* data, size_t size) override
    {
        return mbedtls_net_send(&mServerFd, static_cast<const unsigned char*>(data), size);
    }

private:
    mbedtls_net_context mServerFd;
};

class Server {
public:
    Server(std::promise<void> listen)
        : mListen(std::move(listen))
    {
    }

    ~Server()
    {
        mbedtls_net_free(&mClientFd);
        mbedtls_net_free(&mListenFd);
        mbedtls_pk_free(&mPrivKeyCtx);
        mbedtls_x509_crt_free(&mCertChain);
        mbedtls_x509_crt_free(&mCACert);
        mbedtls_ctr_drbg_free(&mCtrDrbg);
        mbedtls_entropy_free(&mEntropy);
        mbedtls_ssl_config_free(&mConf);
        mbedtls_ssl_free(&mSsl);
    }

    aos::Error Run()
    {
        auto err = Init();
        if (!err.IsNone()) {
            return err;
        }

        if ((err = ParseCACert()) != aos::ErrorEnum::eNone) {
            return err;
        }

        if ((err = ParseCertChain()) != aos::ErrorEnum::eNone) {
            return err;
        }

        if ((err = ParsePK()) != aos::ErrorEnum::eNone) {
            return err;
        }

        if ((err = SetupSSLConfig()) != aos::ErrorEnum::eNone) {
            return err;
        }

        if ((err = Bind()) != aos::ErrorEnum::eNone) {
            return err;
        }

        if ((err = Listen()) != aos::ErrorEnum::eNone) {
            return err;
        }

        return err;
    }

private:
    static constexpr auto pers = "ssl_server";

    aos::Error Init()
    {
        mbedtls_ssl_init(&mSsl);
        mbedtls_ssl_config_init(&mConf);
        mbedtls_entropy_init(&mEntropy);
        mbedtls_ctr_drbg_init(&mCtrDrbg);
        mbedtls_x509_crt_init(&mCACert);
        mbedtls_x509_crt_init(&mCertChain);
        mbedtls_pk_init(&mPrivKeyCtx);
        mbedtls_net_init(&mListenFd);
        mbedtls_net_init(&mClientFd);

        return mbedtls_ctr_drbg_seed(
            &mCtrDrbg, mbedtls_entropy_func, &mEntropy, reinterpret_cast<const unsigned char*>(pers), strlen(pers));
    }

    aos::Error ParseCACert()
    {
        aos::StaticString<aos::crypto::cCertPEMLen> mCACertPem;

        auto err = aos::fs::ReadFileToString(CERT_DIR "/ca.pem", mCACertPem);
        if (!err.IsNone()) {
            return err;
        }

        return mbedtls_x509_crt_parse(
            &mCACert, reinterpret_cast<const unsigned char*>(mCACertPem.Get()), mCACertPem.Size() + 1);
    }

    aos::Error ParseCertChain()
    {
        aos::StaticString<aos::crypto::cCertPEMLen> mCertChainPem;

        auto err = aos::fs::ReadFileToString(CERT_DIR "/server.cer", mCertChainPem);
        if (!err.IsNone()) {
            return err;
        }

        return mbedtls_x509_crt_parse(
            &mCertChain, reinterpret_cast<const unsigned char*>(mCertChainPem.Get()), mCertChainPem.Size() + 1);
    }

    aos::Error ParsePK()
    {
        aos::StaticString<4096> mPKPem;

        auto err = aos::fs::ReadFileToString(CERT_DIR "/server.key", mPKPem);
        if (!err.IsNone()) {
            return err;
        }

        return mbedtls_pk_parse_key(&mPrivKeyCtx, reinterpret_cast<const unsigned char*>(mPKPem.Get()),
            mPKPem.Size() + 1, nullptr, 0, mbedtls_ctr_drbg_random, &mCtrDrbg);
    }

    aos::Error SetupSSLConfig()
    {
        auto ret = mbedtls_ssl_config_defaults(
            &mConf, MBEDTLS_SSL_IS_SERVER, MBEDTLS_SSL_TRANSPORT_STREAM, MBEDTLS_SSL_PRESET_DEFAULT);
        if (ret != 0) {
            return ret;
        }

        mbedtls_ssl_conf_authmode(&mConf, MBEDTLS_SSL_VERIFY_REQUIRED);
        mbedtls_ssl_conf_rng(&mConf, mbedtls_ctr_drbg_random, &mCtrDrbg);
        mbedtls_ssl_conf_ca_chain(&mConf, &mCACert, nullptr);
        mbedtls_ssl_conf_own_cert(&mConf, &mCertChain, &mPrivKeyCtx);

        return mbedtls_ssl_setup(&mSsl, &mConf);
    }

    aos::Error Bind() { return mbedtls_net_bind(&mListenFd, nullptr, "4433", MBEDTLS_NET_PROTO_TCP); }

    aos::Error Listen()
    {
        mbedtls_net_free(&mClientFd);

        mbedtls_ssl_session_reset(&mSsl);

        mListen.set_value();

        auto ret = mbedtls_net_accept(&mListenFd, &mClientFd, nullptr, 0, nullptr);
        if (ret != 0) {
            return ret;
        }

        mbedtls_ssl_set_bio(&mSsl, &mClientFd, mbedtls_net_send, mbedtls_net_recv, nullptr);

        return mbedtls_ssl_handshake(&mSsl);
    }

    mbedtls_ssl_context      mSsl;
    mbedtls_ssl_config       mConf;
    mbedtls_entropy_context  mEntropy;
    mbedtls_ctr_drbg_context mCtrDrbg;
    mbedtls_x509_crt         mCACert;
    mbedtls_x509_crt         mCertChain;
    mbedtls_pk_context       mPrivKeyCtx;
    mbedtls_net_context      mListenFd;
    mbedtls_net_context      mClientFd;
    std::promise<void>       mListen;
};

/***********************************************************************************************************************
 * Setup
 **********************************************************************************************************************/

ZTEST_SUITE(tlschannel, nullptr, nullptr, nullptr, nullptr, nullptr);

/***********************************************************************************************************************
 * Tests
 **********************************************************************************************************************/

ZTEST_F(tlschannel, test_TLSChannelConnect)
{
    psa_status_t status = psa_crypto_init();
    zassert_equal(status, PSA_SUCCESS, "psa_crypto_init failed");

    CertLoaderStub  certLoader;
    CertHandlerStub certHandler;
    ClientChannel   vChannel;

    communication::TLSChannel channel;

    auto err = channel.Init("test", certHandler, certLoader, vChannel);
    zassert_equal(err, aos::ErrorEnum::eNone, "test failed");

    err = channel.SetTLSConfig("client");
    zassert_equal(err, aos::ErrorEnum::eNone, "test failed");

    std::promise<void> listen;
    auto               waitListen = listen.get_future();
    Server             server(std::move(listen));

    auto resServer = std::async(std::launch::async, &Server::Run, &server);
    if (waitListen.wait_for(std::chrono::seconds(2)) == std::future_status::timeout) {
        zassert_unreachable("test failed");
    }

    auto resClient = std::async(std::launch::async, &communication::TLSChannel::Connect, &channel);

    auto errClient = resClient.get();
    auto errServer = resServer.get();

    zassert_equal(errClient, aos::ErrorEnum::eNone, "test failed");
    zassert_equal(errServer, aos::ErrorEnum::eNone, "test failed");
}
```

## src/utils.cpp
```c
/*
 * Copyright (C) 2024 Renesas Electronics Corporation.
 * Copyright (C) 2024 EPAM Systems, Inc.
 *
 * SPDX-License-Identifier: Apache-2.0
 */
#include <pb_decode.h>
#include <vchanapi.h>
#include <zephyr/sys/printk.h>

#include "communication/messagehandler.hpp"
#include "utils/checksum.hpp"

#include "utils.hpp"

/***********************************************************************************************************************
 * Public
 **********************************************************************************************************************/

void TestLogCallback(const char* module, aos::LogLevel level, const aos::String& message)
{
    static std::mutex mutex;
    static auto       startTime = std::chrono::steady_clock::now();

    std::lock_guard<std::mutex> lock(mutex);

    auto now = std::chrono::duration<float>(std::chrono::steady_clock::now() - startTime).count();

    const char* levelStr = "unknown";

    switch (level.GetValue()) {
    case aos::LogLevelEnum::eDebug:
        levelStr = "dbg";
        break;

    case aos::LogLevelEnum::eInfo:
        levelStr = "inf";
        break;

    case aos::LogLevelEnum::eWarning:
        levelStr = "wrn";
        break;

    case aos::LogLevelEnum::eError:
        levelStr = "err";
        break;

    default:
        levelStr = "n/d";
        break;
    }

    printk("%0.3f [%s] %s\n", now, levelStr, message.CStr());
}

aos::Error SendMessageToChannel(CommChannelStub& channel, uint32_t source, const std::string& methodName,
    uint64_t requestID, const std::vector<uint8_t>& data, aos::Error messageError)
{
    auto checksum = CalculateSha256(aos::Array<uint8_t>(data.data(), data.size()));
    if (!checksum.mError.IsNone()) {
        return AOS_ERROR_WRAP(checksum.mError);
    }

    auto header = VChanMessageHeader {source, static_cast<uint32_t>(data.size()), requestID, messageError.Errno(),
        static_cast<int32_t>(messageError.Value())};

    strncpy(header.mMethodName, methodName.c_str(), cMaxMethodLen);

    aos::Array<uint8_t>(header.mSha256, aos::cSHA256Size) = checksum.mValue;

    auto headerPtr = reinterpret_cast<uint8_t*>(&header);

    channel.SendRead(std::vector<uint8_t>(headerPtr, headerPtr + sizeof(VChanMessageHeader)));
    channel.SendRead(data);

    return aos::ErrorEnum::eNone;
}

aos::Error ReceiveMessageFromChannel(CommChannelStub& channel, uint32_t source, const std::string& methodName,
    uint64_t requestID, std::vector<uint8_t>& data)
{
    std::vector<uint8_t> headerData;

    auto err = channel.WaitWrite(headerData, sizeof(VChanMessageHeader), cWaitTimeout);
    if (!err.IsNone()) {
        return AOS_ERROR_WRAP(err);
    }

    auto header = reinterpret_cast<VChanMessageHeader*>(headerData.data());

    if (header->mSource != source) {
        return AOS_ERROR_WRAP(aos::ErrorEnum::eInvalidArgument);
    }

    if (header->mMethodName != methodName) {
        return AOS_ERROR_WRAP(aos::ErrorEnum::eInvalidArgument);
    }

    if (header->mRequestID != requestID) {
        return AOS_ERROR_WRAP(aos::ErrorEnum::eInvalidArgument);
    }

    err = channel.WaitWrite(data, header->mDataSize, cWaitTimeout);
    if (!err.IsNone()) {
        return AOS_ERROR_WRAP(err);
    }

    if (header->mDataSize) {
        auto checksum = CalculateSha256(aos::Array<uint8_t>(data.data(), data.size()));
        if (!checksum.mError.IsNone()) {
            return AOS_ERROR_WRAP(checksum.mError);
        }

        if (checksum.mValue != aos::Array<uint8_t>(header->mSha256, aos::cSHA256Size)) {
            return AOS_ERROR_WRAP(aos::ErrorEnum::eInvalidChecksum);
        }
    }

    if (header->mAosError) {
        return AOS_ERROR_WRAP(static_cast<aos::ErrorEnum>(header->mAosError));
    }

    if (header->mErrno) {
        return AOS_ERROR_WRAP(header->mAosError);
    }

    return aos::ErrorEnum::eNone;
}

aos::Error SendPBMessage(CommChannelStub& channel, uint32_t source, const std::string& methodName, uint64_t requestID,
    const pb_msgdesc_t* fields, const void* message, size_t messageSize)
{
    std::vector<uint8_t> data(messageSize);

    if (messageSize) {
        auto stream = pb_ostream_from_buffer(data.data(), data.size());

        auto status = pb_encode(&stream, fields, message);
        if (!status) {
            return aos::ErrorEnum::eFailed;
        }

        data.resize(stream.bytes_written);
    }

    return SendMessageToChannel(channel, source, methodName, requestID, data);
}

aos::Error ReceivePBMessage(CommChannelStub& channel, uint32_t source, const std::string& methodName,
    uint64_t requestID, const pb_msgdesc_t* fields, void* message, size_t messageSize)
{
    std::vector<uint8_t> data(messageSize);

    auto err = ReceiveMessageFromChannel(channel, source, methodName, requestID, data);
    if (!err.IsNone()) {
        return err;
    }

    if (message && fields) {
        auto stream = pb_istream_from_buffer(data.data(), data.size());

        auto status = pb_decode(&stream, fields, message);
        if (!status) {
            return AOS_ERROR_WRAP(aos::ErrorEnum::eRuntime);
        }
    }

    return aos::ErrorEnum::eNone;
}
```

## src/utils.hpp
```c
/*
 * Copyright (C) 2024 Renesas Electronics Corporation.
 * Copyright (C) 2024 EPAM Systems, Inc.
 *
 * SPDX-License-Identifier: Apache-2.0
 */

#include <pb.h>

#include "stubs/commchannelstub.hpp"

/***********************************************************************************************************************
 * Consts
 **********************************************************************************************************************/

constexpr auto cWaitTimeout = std::chrono::seconds {5};

/***********************************************************************************************************************
 * Public
 **********************************************************************************************************************/

void TestLogCallback(const char* module, aos::LogLevel level, const aos::String& message);

aos::Error SendMessageToChannel(CommChannelStub& channel, uint32_t source, const std::string& methodName,
    uint64_t requestID, const std::vector<uint8_t>& data, aos::Error messageError = aos::ErrorEnum::eNone);

aos::Error ReceiveMessageFromChannel(CommChannelStub& channel, uint32_t source, const std::string& methodName,
    uint64_t requestID, std::vector<uint8_t>& data);

aos::Error SendPBMessage(CommChannelStub& channel, uint32_t source, const std::string& methodName, uint64_t requestID,
    const pb_msgdesc_t* fields = nullptr, const void* message = nullptr, size_t messageSize = 0);

aos::Error ReceivePBMessage(CommChannelStub& channel, uint32_t source, const std::string& methodName,
    uint64_t requestID, const pb_msgdesc_t* fields = nullptr, void* message = nullptr, size_t messageSize = 0);
```
