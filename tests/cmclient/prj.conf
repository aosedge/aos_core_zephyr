## CMakeLists.txt
```
# SPDX-License-Identifier: Apache-2.0

cmake_minimum_required(VERSION 3.20.0)

find_package(
    Zephyr
    COMPONENTS
    REQUIRED HINTS $ENV{ZEPHYR_BASE}
)

set(CMAKE_MODULE_PATH ${APPLICATION_SOURCE_DIR}/../../CMakeModules)

project(cmclient_test)

# ######################################################################################################################
# Config
# ######################################################################################################################

set(AOS_CORE_CONFIG aoscoreconfig.hpp)

# ######################################################################################################################
# Definitions
# ######################################################################################################################

# Aos core configuration
add_definitions(-include ${AOS_CORE_CONFIG})

# ######################################################################################################################
#  Generate API
# ######################################################################################################################

find_package(CoreAPI)

set(CORE_API_CXX_FLAGS
    -I${APPLICATION_SOURCE_DIR}/../../src -I${APPLICATION_SOURCE_DIR}/../../../aos_core_lib_cpp/include -include
    ${CMAKE_CURRENT_BINARY_DIR}/zephyr/include/generated/autoconf.h -include ${AOS_CORE_CONFIG}
)

core_api_generate(${CMAKE_CURRENT_SOURCE_DIR}/../../../aos_core_api ${CMAKE_CURRENT_SOURCE_DIR}/../../scripts)

# ######################################################################################################################
# Includes
# ######################################################################################################################

target_include_directories(app PRIVATE ${APPLICATION_SOURCE_DIR}/../../src)
target_include_directories(app PRIVATE ${APPLICATION_SOURCE_DIR}/../../../aos_core_lib_cpp/include)
target_include_directories(app PRIVATE ${APPLICATION_SOURCE_DIR}/../../mocks/include)
target_include_directories(app PRIVATE ${APPLICATION_SOURCE_DIR}/../../../modules/lib/nanopb)
target_include_directories(app PRIVATE ${CMAKE_CURRENT_BINARY_DIR})

# ######################################################################################################################
# Target
# ######################################################################################################################

target_sources(
    app
    PRIVATE src/main.cpp
            src/mocklauncher.cpp
            src/mockdownloader.cpp
            src/mockconnectionsubscriber.cpp
            src/mockresourcemonitor.cpp
            ../../src/cmclient/cmclient.cpp
            ../../src/utils/checksum.cpp
)
```

## Kconfig
```
# Copyright (C) 2023 Renesas Electronics Corporation.
# Copyright (C) 2023 EPAM Systems, Inc.
#
# SPDX-License-Identifier: Apache-2.0

mainmenu "Aos zephyr application"

config AOS_DOMD_ID
	int "DomD id"
	default 1

config AOS_SM_VCHAN_PATH
	string "Path to the SM vchan"
	default "/vchan/sm"

config AOS_SM_VCHAN_TX_PATH
	string "Path to the SM vchan"
	default "/vchan/sm_tx"

config AOS_SM_VCHAN_RX_PATH
	string "Path to the SM vchan"
	default "/vchan/sm_rx"

config AOS_RUNTIME_DIR
	string "Aos runtime dir"
	default "/aos/runtime"

config AOS_SERVICES_DIR
	string "Aos services dir"
	default "/aos/services"

config AOS_NODE_ID
	string "Node id"
	default "NODE_0"

config AOS_NODE_TYPE
	string "Node type"
	default "NODE_TYPE1"

config AOS_NUM_CPU
	int "Count of CPUs for domain with Zephyr"
	default 1

config AOS_TOTAL_RAM
	int "Total RAM of the domain"
	default 204800

config AOS_PARTITION_SIZE
	int "Partition size"
	default 209715200

config AOS_DISK_MOUNT_POINT
	string "Disk mount point"
	default "/aos"

config AOS_CLOCK_SYNC_PERIOD_SEC
	int "Clock sync period in seconds"
	default 1

source "Kconfig"
```

## prj.conf
```kconfig
# Enable C++

CONFIG_CPP=y

# Enable test suit

CONFIG_ZTEST=y
CONFIG_ZTEST_NEW_API=y

# Enable debug for tests

CONFIG_DEBUG=y

# Enable nanopb lib

CONFIG_NANOPB=y

# Enable tiny crypt lib

CONFIG_TINYCRYPT=y
CONFIG_TINYCRYPT_SHA256=y
```

## src/main.cpp
```c
/*
 * Copyright (C) 2023 Renesas Electronics Corporation.
 * Copyright (C) 2023 EPAM Systems, Inc.
 *
 * SPDX-License-Identifier: Apache-2.0
 */

#include <zephyr/tc_util.h>
#include <zephyr/ztest.h>

#include <pb_decode.h>
#include <proto/servicemanager/v3/servicemanager.pb.h>
#include <tinycrypt/constants.h>
#include <tinycrypt/sha256.h>
#include <vchanapi.h>

#include <aos/common/tools/log.hpp>

#include "cmclient/cmclient.hpp"
#include "resourcemanager/resourcemanager.hpp"

#include "mockconnectionsubscriber.hpp"
#include "mockdownloader.hpp"
#include "mocklauncher.hpp"
#include "mockresourcemonitor.hpp"

static constexpr char testVersion[6] = "1.0.1";

bool                                 gWaitHeader = true;
bool                                 gReadHead = true;
bool                                 gShutdown = false;
bool                                 gReadyToRead = true;
bool                                 gReadyToCheck = false;
bool                                 gWriteError = false;
uint8_t                              gConnectionCount = 0;
VChanMessageHeader                   gCurrentHeader;
servicemanager_v3_SMOutgoingMessages gReceivedMessage;
servicemanager_v3_SMIncomingMessages gSendMessage;
uint8_t                              gSendBuffer[servicemanager_v3_SMIncomingMessages_size];
aos::Mutex                           gWaitMessageMutex;
aos::ConditionalVariable             gWaitMessageCondVar(gWaitMessageMutex);
aos::Mutex                           gConnectionMutex;
aos::ConditionalVariable             gConnectionCondVar(gConnectionMutex);
aos::Mutex                           gReadMutex;
aos::ConditionalVariable             gReadCondVar(gReadMutex);
size_t                               gCurrentSendBufferSize;
CMClient                             gTestCMClient;
MockLauncher                         gMockLauncher(gWaitMessageCondVar, gWaitMessageMutex, gReadyToCheck);
MockDownloader                       gMockDownloader(gWaitMessageCondVar, gWaitMessageMutex, gReadyToCheck);

using namespace aos;

void TestLogCallback(LogModule module, LogLevel level, const aos::String& message)
{
    printk("[client] %s \n", message.CStr());
}

aos::Error ResourceManager::GetUnitConfigInfo(char* version) const
{
    printk("[test] GetUnitConfigInfo\n");

    strcpy(version, testVersion);

    return aos::ErrorEnum::eNone;
}

aos::Error ResourceManager::CheckUnitConfig(const char* version, const char* unitConfig) const
{
    return aos::ErrorEnum::eNone;
}

aos::Error ResourceManager::UpdateUnitConfig(const char* version, const char* unitConfig)
{
    return aos::ErrorEnum::eNone;
}

int vch_open(domid_t domain, const char* path, size_t min_rs, size_t min_ws, struct vch_handle* h)
{
    return 0;
}

int vch_connect(domid_t domain, const char* path, struct vch_handle* h)
{
    printk("[test] Connection Done %s\n", path);
    UniqueLock lock(gConnectionMutex);

    gConnectionCount++;
    if (gConnectionCount == 2) {
        gConnectionCondVar.NotifyOne();
    }

    return 0;
}

void vch_close(struct vch_handle* h)
{
}

int vch_read(struct vch_handle* h, void* buf, size_t size)
{
    printk("[test] Start read  %d \n", size);
    if (gReadHead) {
        UniqueLock lock(gReadMutex);
        gReadCondVar.Wait([&] { return gReadyToRead; });
        gReadyToRead = false;
        if (gShutdown) {
            return -1;
        }
    }

    if (gReadHead) {
        auto outStream = pb_ostream_from_buffer(gSendBuffer, servicemanager_v3_SMIncomingMessages_size);
        auto status = pb_encode(&outStream, servicemanager_v3_SMIncomingMessages_fields, &gSendMessage);
        zassert_true(status, "Encoding failed: %s\n", PB_GET_ERROR(&outStream));

        VChanMessageHeader     header;
        tc_sha256_state_struct s;

        int err = tc_sha256_init(&s);
        zassert_false((TC_CRYPTO_SUCCESS != err), "Can't init SHA256: %d", err);

        err = tc_sha256_update(&s, gSendBuffer, outStream.bytes_written);
        zassert_false((TC_CRYPTO_SUCCESS != err), "Can't hash message: %d", err);

        err = tc_sha256_final(header.mSha256, &s);
        zassert_false((TC_CRYPTO_SUCCESS != err), "Can't finish hash message: %d", err);

        header.mDataSize = outStream.bytes_written;

        memcpy(buf, static_cast<void*>(&header), sizeof(VChanMessageHeader));
        gCurrentSendBufferSize = outStream.bytes_written;
    } else {
        memcpy(buf, gSendBuffer, gCurrentSendBufferSize);
    }

    gReadHead = !gReadHead;

    printk("[test] END read  %d \n", size);
    return size;
}

int vch_write(struct vch_handle* h, const void* buf, size_t size)
{
    printk("[test] Start write %d header %d \n", size, gWaitHeader);

    if (gWriteError) {
        return -1;
    }

    if (gWaitHeader) {
        gWaitHeader = false;
        zassert_equal(size, sizeof(VChanMessageHeader), "Incorrect header size");
        memcpy(&gCurrentHeader, buf, sizeof(VChanMessageHeader));

        return size;
    }

    gWaitHeader = true;

    zassert_equal(size, gCurrentHeader.mDataSize, "Header and message length mismatch");

    tc_sha256_state_struct s;
    uint8_t                sha256[32];

    int ret = tc_sha256_init(&s);
    zassert_false((TC_CRYPTO_SUCCESS != ret), "Can't init SHA256: %d", ret);

    ret = tc_sha256_update(&s, (const uint8_t*)buf, size);
    zassert_false((TC_CRYPTO_SUCCESS != ret), "Can't hash message: %d", ret);

    ret = tc_sha256_final(sha256, &s);
    zassert_false((TC_CRYPTO_SUCCESS != ret), "Can't finish hash message: %d", ret);
    zassert_false((0 != memcmp(sha256, gCurrentHeader.mSha256, 32)), "Sha256 mismatch");

    gReceivedMessage = servicemanager_v3_SMOutgoingMessages servicemanager_v3_SMOutgoingMessages_init_zero;

    pb_istream_t stream = pb_istream_from_buffer((const pb_byte_t*)buf, size);
    auto         status = pb_decode(&stream, servicemanager_v3_SMOutgoingMessages_fields, &gReceivedMessage);
    zassert_true(status, "Decoding failed: %s", PB_GET_ERROR(&stream));

    printk("[test] Notify msg %d \n", gReceivedMessage.which_SMOutgoingMessage);
    {
        UniqueLock lock(gWaitMessageMutex);
        gReadyToCheck = true;
        gWaitMessageCondVar.NotifyOne();
    }

    return size;
}

void tesUpdateAndRunInstanceStatuses()
{
    StaticArray<InstanceStatus, 1> instances;
    InstanceStatus                 status;

    status.mInstanceIdent.mServiceID = aos::String("service1");
    status.mInstanceIdent.mSubjectID = aos::String("subject1");
    status.mInstanceIdent.mInstance = 0;
    status.mAosVersion = 12;
    status.mRunState = InstanceRunStateEnum::eActive;
    status.mError = ErrorEnum::eNone;

    instances.PushBack(status);

    auto err = gTestCMClient.InstancesRunStatus(instances);
    zassert_true(err.IsNone(), "Error send run status: %s", err.Message());
    zassert_equal(gReceivedMessage.which_SMOutgoingMessage,
        servicemanager_v3_SMOutgoingMessages_run_instances_status_tag, "Instance run status expected %d",
        gReceivedMessage.which_SMOutgoingMessage);
    zassert_equal(
        gReceivedMessage.SMOutgoingMessage.run_instances_status.instances_count, 1, "Incorrect run instances count");
    zassert_false(
        strcmp(gReceivedMessage.SMOutgoingMessage.run_instances_status.instances[0].instance.service_id, "service1"),
        "Incorrect Service id  %s",
        gReceivedMessage.SMOutgoingMessage.run_instances_status.instances[0].instance.service_id);

    err = gTestCMClient.InstancesUpdateStatus(instances);
    zassert_true(err.IsNone(), "Error send update status: %s", err.Message());
    zassert_equal(gReceivedMessage.which_SMOutgoingMessage,
        servicemanager_v3_SMOutgoingMessages_update_instances_status_tag, "Instance run status expected %d",
        gReceivedMessage.which_SMOutgoingMessage);
    zassert_equal(gReceivedMessage.SMOutgoingMessage.update_instances_status.instances_count, 1,
        "Incorrect update instances count");
    zassert_false(
        strcmp(gReceivedMessage.SMOutgoingMessage.update_instances_status.instances[0].instance.subject_id, "subject1"),
        "Incorrect Subject id  %s",
        gReceivedMessage.SMOutgoingMessage.update_instances_status.instances[0].instance.subject_id);
}

void testGetUnitConfigStatus()
{
    gReadyToCheck = false; // skip previous notify
    gSendMessage.which_SMIncomingMessage = servicemanager_v3_SMIncomingMessages_get_unit_config_status_tag;

    {
        UniqueLock lock(gReadMutex);
        gReadyToRead = true;
        gReadCondVar.NotifyOne();
    }

    // Wait node config status
    {
        UniqueLock lock(gWaitMessageMutex);
        gWaitMessageCondVar.Wait([&] { return gReadyToCheck; });
        gReadyToCheck = false;
    }

    zassert_equal(gReceivedMessage.which_SMOutgoingMessage, servicemanager_v3_SMOutgoingMessages_unit_config_status_tag,
        "Unit configuration status expected %d", gReceivedMessage.which_SMOutgoingMessage);
    zassert_false((0 != strcmp(gReceivedMessage.SMOutgoingMessage.unit_config_status.vendor_version, testVersion)),
        "Incorrect unit config version");
}

void testCheckUnitConfig()
{
    gSendMessage.which_SMIncomingMessage = servicemanager_v3_SMIncomingMessages_check_unit_config_tag;
    strcpy(gSendMessage.SMIncomingMessage.check_unit_config.vendor_version, testVersion);
    {
        UniqueLock lock(gReadMutex);
        gReadyToRead = true;
        gReadCondVar.NotifyOne();
    }

    // Wait node config status
    {
        UniqueLock lock(gWaitMessageMutex);
        gWaitMessageCondVar.Wait([&] { return gReadyToCheck; });
        gReadyToCheck = false;
    }

    zassert_equal(gReceivedMessage.which_SMOutgoingMessage, servicemanager_v3_SMOutgoingMessages_unit_config_status_tag,
        "Unit configuration status expected");
    zassert_false((0 != strcmp(gReceivedMessage.SMOutgoingMessage.unit_config_status.vendor_version, testVersion)),
        "Incorrect unit config version");
}

void testUpdateUnitConfig()
{
    gSendMessage.which_SMIncomingMessage = servicemanager_v3_SMIncomingMessages_set_unit_config_tag;
    strcpy(gSendMessage.SMIncomingMessage.set_unit_config.vendor_version, testVersion);
    {
        UniqueLock lock(gReadMutex);
        gReadyToRead = true;
        gReadCondVar.NotifyOne();
    }

    // Wait node config status
    {
        UniqueLock lock(gWaitMessageMutex);
        gWaitMessageCondVar.Wait([&] { return gReadyToCheck; });
        gReadyToCheck = false;
    }

    zassert_equal(gReceivedMessage.which_SMOutgoingMessage, servicemanager_v3_SMOutgoingMessages_unit_config_status_tag,
        "Unit configuration status expected");

    zassert_false((0 != strcmp(gReceivedMessage.SMOutgoingMessage.unit_config_status.vendor_version, testVersion)),
        "Incorrect unit config version");
}

void testRunInstances()
{
    gSendMessage.which_SMIncomingMessage = servicemanager_v3_SMIncomingMessages_run_instances_tag;
    gSendMessage.SMIncomingMessage.run_instances
        = servicemanager_v3_RunInstances servicemanager_v3_RunInstances_init_zero;

    gSendMessage.SMIncomingMessage.run_instances.force_restart = true;
    gMockLauncher.mExpectedForceRestart = true;

    gSendMessage.SMIncomingMessage.run_instances.services_count = 1;

    auto&            pbService = gSendMessage.SMIncomingMessage.run_instances.services[0];
    aos::ServiceInfo expectedService;

    pbService.has_version_info = true;
    pbService.version_info.aos_version = 42;
    expectedService.mVersionInfo.mAosVersion = 42;
    strcpy(pbService.url, "Service1URL");
    expectedService.mURL = "Service1URL";
    strcpy(pbService.service_id, "ServiceID1");
    expectedService.mServiceID = aos::String("ServiceID1");
    strcpy(pbService.url, "URLServiceID1");
    expectedService.mURL = aos::String("URLServiceID1");

    gMockLauncher.mExpectedServices.PushBack(expectedService);

    gSendMessage.SMIncomingMessage.run_instances.instances_count = 1;

    auto&             pbInstance = gSendMessage.SMIncomingMessage.run_instances.instances[0];
    aos::InstanceInfo expectedInstance;

    pbInstance.has_instance = true;
    pbInstance.instance.instance = 1;
    expectedInstance.mInstanceIdent.mInstance = 1;
    strcpy(pbInstance.instance.service_id, "InstanceService1");
    expectedInstance.mInstanceIdent.mServiceID = "InstanceService1";
    strcpy(pbInstance.instance.subject_id, "Subject1");
    expectedInstance.mInstanceIdent.mSubjectID = "Subject1";
    pbInstance.priority = 42;
    expectedInstance.mPriority = 42;

    gMockLauncher.mExpectedInstances.PushBack(expectedInstance);

    {
        UniqueLock lock(gReadMutex);
        gReadyToRead = true;
        gReadCondVar.NotifyOne();
    }

    {
        UniqueLock lock(gWaitMessageMutex);
        gWaitMessageCondVar.Wait([&] { return gReadyToCheck; });
        gReadyToCheck = false;
    }
}

void testNodeMonitoring()
{
    aos::monitoring::NodeMonitoringData monitoringData;
    monitoringData.mNodeID = "NodeID";
    monitoringData.mMonitoringData.mCPU = 42;
    monitoringData.mMonitoringData.mRAM = 43;
    aos::monitoring::PartitionInfo partitionInfo;
    partitionInfo.mName = "PartitionName";
    partitionInfo.mUsedSize = 45;

    monitoringData.mMonitoringData.mDisk.PushBack(partitionInfo);

    aos::monitoring::InstanceMonitoringData instanceMonitoringData;
    instanceMonitoringData.mInstanceID = "InstanceID";
    instanceMonitoringData.mMonitoringData.mCPU = 44;
    instanceMonitoringData.mMonitoringData.mRAM = 45;

    monitoringData.mServiceInstances.PushBack(instanceMonitoringData);

    gTestCMClient.SendMonitoringData(monitoringData);

    {
        UniqueLock lock(gWaitMessageMutex);
        gWaitMessageCondVar.Wait([&] { return gReadyToCheck; });
        gReadyToCheck = false;
    }

    zassert_equal(gReceivedMessage.which_SMOutgoingMessage, servicemanager_v3_SMOutgoingMessages_node_monitoring_tag,
        "Node monitoring expected");

    zassert_equal(gReceivedMessage.SMOutgoingMessage.node_monitoring.monitoring_data.cpu,
        monitoringData.mMonitoringData.mCPU, "Incorrect CPU");
    zassert_equal(gReceivedMessage.SMOutgoingMessage.node_monitoring.monitoring_data.ram,
        monitoringData.mMonitoringData.mRAM, "Incorrect RAM");

    zassert_equal(
        gReceivedMessage.SMOutgoingMessage.node_monitoring.monitoring_data.disk_count, 1, "Incorrect disk count");

    zassert_equal(gReceivedMessage.SMOutgoingMessage.node_monitoring.monitoring_data.disk[0].used_size,
        partitionInfo.mUsedSize, "Incorrect used size");
    zassert_equal(gReceivedMessage.SMOutgoingMessage.node_monitoring.monitoring_data.disk[0].name, partitionInfo.mName,
        "Incorrect name");

    zassert_equal(
        gReceivedMessage.SMOutgoingMessage.node_monitoring.instance_monitoring_count, 1, "Incorrect instances count");

    zassert_equal(gReceivedMessage.SMOutgoingMessage.node_monitoring.instance_monitoring[0].monitoring_data.cpu,
        instanceMonitoringData.mMonitoringData.mCPU, "Incorrect instance CPU");
    zassert_equal(gReceivedMessage.SMOutgoingMessage.node_monitoring.instance_monitoring[0].monitoring_data.ram,
        instanceMonitoringData.mMonitoringData.mRAM, "Incorrect instance RAM");

    gWriteError = true;

    auto err = gTestCMClient.SendMonitoringData(monitoringData);
    zassert_false(err.IsNone(), "Error expected");

    gWriteError = false;
}

void testImageDownloadInstances()
{
    printk("[test] ----------- GetUnitConfigInfo ---------------- \n");
    ImageContentRequest request;
    request.contentType = DownloadContentType::Enum::eService;
    request.requestID = 100500;
    request.url = aos::StaticString<50>("/file/url");

    gTestCMClient.SendImageContentRequest(request);

    {
        UniqueLock lock(gWaitMessageMutex);
        gWaitMessageCondVar.Wait([&] { return gReadyToCheck; });
        gReadyToCheck = false;
    }

    zassert_equal(gReceivedMessage.which_SMOutgoingMessage,
        servicemanager_v3_SMOutgoingMessages_image_content_request_tag, "Image content request expected");
    zassert_equal(
        gReceivedMessage.SMOutgoingMessage.image_content_request.request_id, request.requestID, "Incorrect request id");
    zassert_equal(aos::String(gReceivedMessage.SMOutgoingMessage.image_content_request.content_type), "service",
        "Incorrect request content type");
    zassert_equal(
        aos::String(gReceivedMessage.SMOutgoingMessage.image_content_request.url), request.url.CStr(), "Incorrect url");

    gSendMessage.which_SMIncomingMessage = servicemanager_v3_SMIncomingMessages_image_content_info_tag;
    gSendMessage.SMIncomingMessage.image_content_info
        = servicemanager_v3_ImageContentInfo servicemanager_v3_ImageContentInfo_init_zero;
    gSendMessage.SMIncomingMessage.image_content_info.request_id = 100500;
    gMockDownloader.mExpectedContent.requestID = 100500;
    gSendMessage.SMIncomingMessage.image_content_info.image_files_count = 1;

    FileInfo                     expectedFileInfo;
    servicemanager_v3_ImageFile& imageFile = gSendMessage.SMIncomingMessage.image_content_info.image_files[0];

    expectedFileInfo.size = 6400000;
    imageFile.size = 6400000;
    expectedFileInfo.relativePath = "imagePath";
    strcpy(imageFile.relative_path, "imagePath");
    memcpy(expectedFileInfo.sha256.Get(), "SHA256", 7);
    memcpy(imageFile.sha256.bytes, "SHA256", 7);
    imageFile.sha256.size = 7;

    gMockDownloader.mExpectedContent.files.PushBack(expectedFileInfo);

    {
        UniqueLock lock(gReadMutex);
        gReadyToRead = true;
        gReadCondVar.NotifyOne();
    }

    {
        UniqueLock lock(gWaitMessageMutex);
        gWaitMessageCondVar.Wait([&] { return gReadyToCheck; });
        gReadyToCheck = false;
    }

    gSendMessage.which_SMIncomingMessage = servicemanager_v3_SMIncomingMessages_image_content_tag;
    gSendMessage.SMIncomingMessage.image_content
        = servicemanager_v3_ImageContent servicemanager_v3_ImageContent_init_zero;

    gSendMessage.SMIncomingMessage.image_content.request_id = 100501;
    gMockDownloader.mExpectedChunk.requestID = 100501;
    gSendMessage.SMIncomingMessage.image_content.parts_count = 10;
    gMockDownloader.mExpectedChunk.partsCount = 10;
    gSendMessage.SMIncomingMessage.image_content.part = 2;
    gMockDownloader.mExpectedChunk.part = 2;
    strcpy(gSendMessage.SMIncomingMessage.image_content.relative_path, "Some/Path");
    gMockDownloader.mExpectedChunk.relativePath = "Some/Path";
    gSendMessage.SMIncomingMessage.image_content.data.size = strlen("File content");
    strcpy((char*)gSendMessage.SMIncomingMessage.image_content.data.bytes, "File content");
    gMockDownloader.mExpectedChunk.data = aos::Array<uint8_t>(gSendMessage.SMIncomingMessage.image_content.data.bytes,
        gSendMessage.SMIncomingMessage.image_content.data.size);

    {
        UniqueLock lock(gReadMutex);
        gReadyToRead = true;
        gReadCondVar.NotifyOne();
    }

    {
        UniqueLock lock(gWaitMessageMutex);
        gWaitMessageCondVar.Wait([&] { return gReadyToCheck; });
        gReadyToCheck = false;
    }
}

ZTEST_SUITE(cmclient, NULL, NULL, NULL, NULL, NULL);

ZTEST(cmclient, test_node_config)
{
    ResourceManager          mockResourceManager;
    MockResourceMonitor      mockResourceMonitor;
    MockConnectionSubscriber mockConnectionSubscriber;

    aos::Log::SetCallback(TestLogCallback);

    auto err = gTestCMClient.Subscribes(&mockConnectionSubscriber);
    zassert_true(err.IsNone(), "subscribe error: %s", err.Message());

    gTestCMClient.Init(gMockLauncher, mockResourceManager, gMockDownloader, mockResourceMonitor);
    zassert_true(err.IsNone(), "init error: %s", err.Message());

    // wait open
    {
        UniqueLock lock(gConnectionMutex);
        gConnectionCondVar.Wait([&] { return gConnectionCount > 1; });
    }

    // wait onConnect notification
    sleep(1);

    zassert_true(mockConnectionSubscriber.IsConnected(), "Connection expected");

    gTestCMClient.Unsubscribes(&mockConnectionSubscriber);

    // Wait node config
    {
        UniqueLock lock(gWaitMessageMutex);
        gWaitMessageCondVar.Wait([&] { return gReadyToCheck; });
        gReadyToCheck = false;
    }

    zassert_equal(gReceivedMessage.which_SMOutgoingMessage, servicemanager_v3_SMOutgoingMessages_node_configuration_tag,
        "Node configuration expected");

    tesUpdateAndRunInstanceStatuses();
    testGetUnitConfigStatus();
    testCheckUnitConfig();
    testUpdateUnitConfig();
    testRunInstances();
    testImageDownloadInstances();
    testNodeMonitoring();

    // release read tread to shutdown
    UniqueLock lock(gReadMutex);
    gReadyToRead = true;
    gShutdown = true;
    gReadCondVar.NotifyOne();
}
```

## src/mockclocksync.cpp
```c
/*
 * Copyright (C) 2023 Renesas Electronics Corporation.
 * Copyright (C) 2023 EPAM Systems, Inc.
 *
 * SPDX-License-Identifier: Apache-2.0
 */

#include "mockclocksync.hpp"

aos::Error MockClockSync::ProcessClockSync(struct timespec ts)
{
    return aos::Error();
}
```

## src/mockclocksync.hpp
```c
/*
 * Copyright (C) 2023 Renesas Electronics Corporation.
 * Copyright (C) 2023 EPAM Systems, Inc.
 *
 * SPDX-License-Identifier: Apache-2.0
 */

#ifndef MOCK_CLOCKSYNC_HPP_
#define MOCK_CLOCKSYNC_HPP_

#include "clocksync/clocksync.hpp"

class MockClockSync : public ClockSyncItf {
public:
    aos::Error ProcessClockSync(struct timespec ts) override;
};

#endif
```

## src/mockconnectionsubscriber.cpp
```c
/*
 * Copyright (C) 2023 Renesas Electronics Corporation.
 * Copyright (C) 2023 EPAM Systems, Inc.
 *
 * SPDX-License-Identifier: Apache-2.0
 */

#include "mockconnectionsubscriber.hpp"

void MockConnectionSubscriber::OnConnect()
{
    connected = true;
}

void MockConnectionSubscriber::OnDisconnect()
{
    connected = false;
}

bool MockConnectionSubscriber::IsConnected() const
{
    return connected;
}
```

## src/mockconnectionsubscriber.hpp
```c
/*
 * Copyright (C) 2023 Renesas Electronics Corporation.
 * Copyright (C) 2023 EPAM Systems, Inc.
 *
 * SPDX-License-Identifier: Apache-2.0
 */

#include "aos/common/connectionsubsc.hpp"

using namespace aos;

class MockConnectionSubscriber : public ConnectionSubscriberItf {
public:
    /**
     * Notifies publisher is connected.
     */
    void OnConnect() override;

    /**
     * Notifies publisher is disconnected.
     */
    void OnDisconnect() override;

    /**
     * Returns true if the subscriber is connected.
     */
    bool IsConnected() const;

private:
    bool connected {};
};
```

## src/mockdownloader.cpp
```c
/*
 * Copyright (C) 2023 Renesas Electronics Corporation.
 * Copyright (C) 2023 EPAM Systems, Inc.
 *
 * SPDX-License-Identifier: Apache-2.0
 */

#include <zephyr/tc_util.h>
#include <zephyr/ztest.h>

#include <aos/common/tools/thread.hpp>

#include "mockdownloader.hpp"

aos::Error MockDownloader::ReceiveFileChunk(const FileChunk& chunk)
{
    zassert_equal(mExpectedChunk.relativePath, chunk.relativePath, "Incorrect rel path exp: %s rec:%s",
        mExpectedChunk.relativePath.CStr(), chunk.relativePath.CStr());
    zassert_equal(mExpectedChunk.part, chunk.part, "Incorrect part");
    zassert_equal(mExpectedChunk.partsCount, chunk.partsCount, "Incorrect part count");
    zassert_equal(mExpectedChunk.requestID, chunk.requestID, "Incorrect request id");
    zassert_false(memcmp(mExpectedChunk.data.begin(), chunk.data.begin(), chunk.data.Size()), "Incorrect chunk data");

    aos::UniqueLock lock(mWaitMessageMutex);
    mReadyToProcess = true;
    mWaitMessageCondVar.NotifyOne();

    return aos::ErrorEnum::eNone;
};

aos::Error MockDownloader::ReceiveImageContentInfo(const ImageContentInfo& content)
{
    zassert_equal(mExpectedContent.error, content.error, "Incorrect error msg");
    zassert_equal(mExpectedContent.requestID, content.requestID, "Incorrect request ID");
    zassert_equal(mExpectedContent.files.Size(), content.files.Size(), "Incorrect count of files");
    zassert_equal(mExpectedContent.files[0].relativePath, content.files[0].relativePath, "Incorrect rel path");
    zassert_false(strcmp((char*)mExpectedContent.files[0].sha256.Get(), (char*)content.files[0].sha256.Get()),
        "Incorrect sha256");

    aos::UniqueLock lock(mWaitMessageMutex);
    mReadyToProcess = true;
    mWaitMessageCondVar.NotifyOne();

    return aos::ErrorEnum::eNone;
};
```

## src/mockdownloader.hpp
```c
/*
 * Copyright (C) 2023 Renesas Electronics Corporation.
 * Copyright (C) 2023 EPAM Systems, Inc.
 *
 * SPDX-License-Identifier: Apache-2.0
 */

#include "downloader/downloader.hpp"

class MockDownloader : public DownloadReceiverItf {
public:
    MockDownloader(aos::ConditionalVariable& waitMessageCondVar, aos::Mutex& waitMessageMutex, bool& readyToProcess)
        : mWaitMessageCondVar(waitMessageCondVar)
        , mWaitMessageMutex(waitMessageMutex)
        , mReadyToProcess(readyToProcess)
    {
    }

    aos::Error ReceiveFileChunk(const FileChunk& chunk) override;

    aos::Error ReceiveImageContentInfo(const ImageContentInfo& content) override;

    ImageContentInfo mExpectedContent;
    FileChunk        mExpectedChunk;

private:
    aos::ConditionalVariable& mWaitMessageCondVar;
    aos::Mutex&               mWaitMessageMutex;
    bool&                     mReadyToProcess;
};
```

## src/mocklauncher.cpp
```c
/*
 * Copyright (C) 2023 Renesas Electronics Corporation.
 * Copyright (C) 2023 EPAM Systems, Inc.
 *
 * SPDX-License-Identifier: Apache-2.0
 */

#include <zephyr/tc_util.h>
#include <zephyr/ztest.h>

#include <aos/common/tools/thread.hpp>

#include "mocklauncher.hpp"

Error MockLauncher::RunInstances(const Array<ServiceInfo>& services, const Array<LayerInfo>& layers,
    const Array<InstanceInfo>& instances, bool forceRestart)
{

    zassert_equal(mExpectedForceRestart, forceRestart, "Incorrect force restart flag");

    zassert_equal(mExpectedServices.Size(), services.Size(), "Incorrect count of services");
    zassert_equal(
        mExpectedServices[0].mVersionInfo.mAosVersion, services[0].mVersionInfo.mAosVersion, "Incorrect Aos version");
    zassert_equal(mExpectedServices[0].mServiceID, services[0].mServiceID, "Incorrect ServiceID");
    zassert_equal(mExpectedServices[0].mURL, services[0].mURL, "Incorrect URL");

    zassert_equal(mExpectedInstances.Size(), instances.Size(), "Incorrect count of instances");
    zassert_equal(mExpectedInstances[0].mInstanceIdent.mServiceID, instances[0].mInstanceIdent.mServiceID,
        "Incorrect service id for instance");
    zassert_equal(mExpectedInstances[0].mInstanceIdent.mSubjectID, instances[0].mInstanceIdent.mSubjectID,
        "Incorrect subject id for instance");
    zassert_equal(
        mExpectedInstances[0].mInstanceIdent.mInstance, instances[0].mInstanceIdent.mInstance, "Incorrect instance");
    zassert_equal(
        mExpectedInstances[0].mPriority, instances[0].mPriority, "Incorrect priority %d", instances[0].mPriority);

    zassert_equal(mExpectedLayers.Size(), layers.Size(), "Incorrect count of layers");

    UniqueLock lock(mWaitMessageMutex);
    mReadyToProcess = true;
    mWaitMessageCondVar.NotifyOne();

    return ErrorEnum::eNone;
}

Error MockLauncher::RunLastInstances()
{
    return ErrorEnum::eNone;
}
```

## src/mocklauncher.hpp
```c
/*
 * Copyright (C) 2023 Renesas Electronics Corporation.
 * Copyright (C) 2023 EPAM Systems, Inc.
 *
 * SPDX-License-Identifier: Apache-2.0
 */

#include <aos/sm/launcher.hpp>

using namespace aos;

static constexpr size_t TestArraysSize = 10;

class MockLauncher : public sm::launcher::LauncherItf {
public:
    MockLauncher(aos::ConditionalVariable& waitMessageCondVar, aos::Mutex& waitMessageMutex, bool& readyToProcess)
        : mWaitMessageCondVar(waitMessageCondVar)
        , mWaitMessageMutex(waitMessageMutex)
        , mReadyToProcess(readyToProcess)
    {
    }

    Error RunInstances(const Array<ServiceInfo>& services, const Array<LayerInfo>& layers,
        const Array<InstanceInfo>& instances, bool forceRestart) override;

    Error RunLastInstances() override;

    StaticArray<ServiceInfo, TestArraysSize>  mExpectedServices;
    StaticArray<LayerInfo, TestArraysSize>    mExpectedLayers;
    StaticArray<InstanceInfo, TestArraysSize> mExpectedInstances;
    bool                                      mExpectedForceRestart;
    aos::ConditionalVariable&                 mWaitMessageCondVar;
    aos::Mutex&                               mWaitMessageMutex;
    bool&                                     mReadyToProcess;
};
```

## src/mockresourcemonitor.cpp
```c
/*
 * Copyright (C) 2023 Renesas Electronics Corporation.
 * Copyright (C) 2023 EPAM Systems, Inc.
 *
 * SPDX-License-Identifier: Apache-2.0
 */

#include "mockresourcemonitor.hpp"

Error MockResourceMonitor::GetNodeInfo(monitoring::NodeInfo& nodeInfo) const
{
    return ErrorEnum::eNone;
}

Error MockResourceMonitor::StartInstanceMonitoring(
    const String& instanceID, const monitoring::InstanceMonitorParams& monitoringConfig)
{
    return ErrorEnum::eNone;
}

Error MockResourceMonitor::StopInstanceMonitoring(const String& instanceID)
{
    return ErrorEnum::eNone;
}
```

## src/mockresourcemonitor.hpp
```c
/*
 * Copyright (C) 2023 Renesas Electronics Corporation.
 * Copyright (C) 2023 EPAM Systems, Inc.
 *
 * SPDX-License-Identifier: Apache-2.0
 */

#include "aos/common/resourcemonitor.hpp"

using namespace aos;

class MockResourceMonitor : public monitoring::ResourceMonitorItf {
public:
    /**
     * Gets the node info object
     *
     * @param nodeInfo node info
     * @return Error
     */
    Error GetNodeInfo(monitoring::NodeInfo& nodeInfo) const override;

    /**
     * Starts instance monitoring
     *
     * @param instanceID instance ident
     * @param monitoringConfig monitoring config
     * @return Error
     */
    Error StartInstanceMonitoring(
        const String& instanceID, const monitoring::InstanceMonitorParams& monitoringConfig) override;

    /**
     * Stops instance monitoring
     *
     * @param instanceID instance ident
     * @return Error
     */
    Error StopInstanceMonitoring(const String& instanceID) override;
};
```
