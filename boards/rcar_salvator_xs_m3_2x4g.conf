## boards/rcar_salvator_xs_m3_2x4g.conf
```kconfig
#
# Copyright (c) 2023 EPAM Systems
#
# SPDX-License-Identifier: Apache-2.0
#

# Kernel virtual memory size

CONFIG_KERNEL_VM_SIZE=0x4000000
CONFIG_PARTIAL_DEVICE_TREE_SIZE=70000

# Aos config

CONFIG_AOS_NODE_ID="gen3-dom0"
CONFIG_AOS_NODE_TYPE="zephyr-gen3-dom0"
```

## boards/rcar_spider.conf
```kconfig
#
# Copyright (c) 2023 EPAM Systems
#
# SPDX-License-Identifier: Apache-2.0
#

# Kernel virtual memory size

CONFIG_KERNEL_VM_SIZE=0x4000000
CONFIG_PARTIAL_DEVICE_TREE_SIZE=80000

# Aos config

CONFIG_AOS_NODE_ID="gen4-dom0"
CONFIG_AOS_NODE_TYPE="zephyr-gen4-dom0"

CONFIG_MINIMAL_LIBC_MALLOC_ARENA_SIZE=8192
CONFIG_FS_LITTLEFS_FC_HEAP_SIZE=8192
CONFIG_SHELL_STACK_SIZE=8192

CONFIG_DISK_ACCESS=y
CONFIG_DISK_DRIVERS=y
CONFIG_DISK_DRIVER_MMC=y

CONFIG_MMC_RCAR=y
CONFIG_MMC_RCA=1

CONFIG_FS_LITTLEFS_BLK_DEV=y

CONFIG_RCAR_MMC_SCC_SUPPORT=n
CONFIG_SD_DATA_TIMEOUT=1000
```

## boards/rcar_spider_ca55.conf
```kconfig
#
# Copyright (c) 2023 EPAM Systems
#
# SPDX-License-Identifier: Apache-2.0
#

# Kernel virtual memory size

CONFIG_KERNEL_VM_SIZE=0x4000000
CONFIG_PARTIAL_DEVICE_TREE_SIZE=80000

# Aos config

CONFIG_SHELL_STACK_SIZE=8192

CONFIG_DISK_ACCESS=y

CONFIG_FS_LITTLEFS_BLK_DEV=y

CONFIG_RCAR_MMC_SCC_SUPPORT=n
CONFIG_SD_DATA_TIMEOUT=1000
```

## boards/rpi_5.conf
```kconfig
# Copyright (c) 2024 EPAM Systems
# SPDX-License-Identifier: Apache-2.0

CONFIG_IPM_CONSOLE_STACK_SIZE=4096

CONFIG_KERNEL_VM_SIZE=0x1000000

CONFIG_XEN_DOMCTL_INTERFACE_VERSION=0x16

CONFIG_XEN_DOM0=y
CONFIG_XEN_DOM0LESS_BOOT=y

CONFIG_NOCACHE_MEMORY=y
CONFIG_FS_MULTI_PARTITION=y

CONFIG_FILE_SYSTEM_LITTLEFS=n

CONFIG_FAT_FILESYSTEM_ELM=y
CONFIG_FS_FATFS_EXFAT=y
CONFIG_FS_FATFS_LBA64=y
CONFIG_FS_FATFS_NUM_FILES=16
CONFIG_FS_FATFS_REENTRANT=y
CONFIG_FS_FATFS_LFN_MODE_STACK=y

CONFIG_DOMD_ENABLE=n

CONFIG_OPTEE_STORAGE_ROOT="/1:/tee"

CONFIG_AOS_LOG_BACKEND_FS_DIR="/1:/aos/logs"
CONFIG_AOS_STORAGE_DIR="/1:/aos/storage"
CONFIG_AOS_RUNTIME_DIR="/2:/tmp/aos/runtime"
CONFIG_AOS_DOWNLOAD_DIR="/1:/aos/download"
CONFIG_AOS_SERVICES_DIR="/1:/aos/services"
CONFIG_AOS_LAUNCHER_STATE_DIR="/1:/aos/launcher/states"
CONFIG_AOS_LAUNCHER_STORAGE_DIR="/1:/aos/launcher/storages"
CONFIG_AOS_LAUNCHER_WORK_DIR="/1:/aos/launcher"
CONFIG_AOS_LAYERS_DIR="/1:/aos/layers"
CONFIG_AOS_NODE_CONFIG_FILE="/1:/aos/node_config.cfg"
CONFIG_AOS_DISK_MOUNT_POINT="/1:"
CONFIG_AOS_NODE_STATUS_FILE="/1:/aos/.nodestatus"
CONFIG_AOS_NODE_ID_FILE="/1:/aos/node-id"
CONFIG_AOS_PKCS11_MODULE_PIN_FILE="/1:/aos/.pkcs11pin"
CONFIG_AOS_HSM_DIR="/1:/tee"
```

## boards/xenvm.conf
```kconfig
#
# Copyright (c) 2023 EPAM Systems
#
# SPDX-License-Identifier: Apache-2.0
#

# Set mem parameters

CONFIG_MAX_XLAT_TABLES=24
```

## boards/xenvm_gicv3.conf
```kconfig
#
# Copyright (c) 2023 EPAM Systems
#
# SPDX-License-Identifier: Apache-2.0
#

# Set mem parameters

CONFIG_MAX_XLAT_TABLES=24

# Enable xen domain support

CONFIG_XEN_INITIAL_DOMAIN=y

# Enable xrun support

CONFIG_XRUN_SHELL_CMDS=y

# Enable FLASH

CONFIG_FLASH=y
CONFIG_FLASH_SHELL=y
CONFIG_FLASH_SIMULATOR=y
CONFIG_FLASH_MAP=y
```

## tests/clocksync/testcase.yaml
```yaml
tests:
  aoszephyrapp.clocksync:
    tags: clocksync
    timeout: 500
    platform_allow: native_posix_64 native_posix
```

## tests/cmclient/testcase.yaml
```yaml
tests:
  aoszephyrapp.cmclient:
    build_only: false
    tags: cmclient
    timeout: 500
    platform_allow: native_posix_64 native_posix
```

## tests/communication/testcase.yaml
```yaml
tests:
  aoszephyrapp.communication:
    build_only: false
    tags: communication
    timeout: 500
    platform_allow: native_posix_64 native_posix
```

## tests/cryptutils/testcase.yaml
```yaml
tests:
  aoszephyrapp.cryptutils:
    tags: cryptutils
    timeout: 500
    platform_allow: native_posix_64 native_posix
```

## tests/downloader/testcase.yaml
```yaml
tests:
  aoszephyrapp.downloader:
    tags: downloader
    timeout: 500
    platform_allow: native_posix_64 native_posix
```

## tests/iamclient/Kconfig
```kconfig
# Copyright (C) 2024 Renesas Electronics Corporation.
# Copyright (C) 2024 EPAM Systems, Inc.
#
# SPDX-License-Identifier: Apache-2.0

mainmenu "Aos zephyr application"

config AOS_CLOCK_SYNC_SEND_PERIOD_SEC
	int "Send clock sync period in seconds"
	default 1

config AOS_CLOCK_SYNC_TIMEOUT_SEC
	int "Clock becomes unsynced if there is no clock sync update during this period."
	default 1

config AOS_CLOCK_SYNC_MAX_DIFF_MSEC
	int "Maximum allowed difference between source and current time."
	default 10000

config AOS_IAM_OPEN_PORT
	int "Aos SM open port"
	default 1

config AOS_IAM_SECURE_PORT
	int "Aos SM secure port"
	default 2

config AOS_PBHANDLER_THREAD_STACK_SIZE
	int "Aos PB handler stack size"
	default 16384

source "Kconfig"
```

## tests/iamclient/testcase.yaml
```yaml
tests:
  aoszephyrapp.iamclient:
    build_only: false
    tags: iamclient
    timeout: 500
    platform_allow: native_posix_64 native_posix
```

## tests/logger/testcase.yaml
```yaml
tests:
  aoszephyrapp.logger:
    build_only: false
    tags: logger
    timeout: 500
    platform_allow: native_posix_64 native_posix
```

## tests/logprovider/testcase.yaml
```yaml
tests:
  aoszephyrapp.logprovider:
    build_only: false
    tags: logprovider
    timeout: 500
    platform_allow: native_posix_64 native_posix
```

## tests/nodeinfoprovider/testcase.yaml
```yaml
tests:
  aoszephyrapp.nodeinfoprovider:
    build_only: false
    tags: nodeinfoprovider
    timeout: 500
    platform_allow: native_posix_64 native_posix
```

## tests/ocispec/testcase.yaml
```yaml
tests:
  aoszephyrapp.ocispec:
    build_only: false
    tags: ocispec
    timeout: 500
    platform_allow: native_posix_64 native_posix
```

## tests/provisioning/testcase.yaml
```yaml
tests:
  aoszephyrapp.provisioning:
    build_only: false
    tags: provisioning
    timeout: 500
    platform_allow: native_posix_64 native_posix
```

## tests/resourcemanager/testcase.yaml
```yaml
tests:
  aoszephyrapp.resourcemanager:
    build_only: false
    tags: resourcemanager
    timeout: 500
    platform_allow: native_posix_64 native_posix
```

## tests/smclient/testcase.yaml
```yaml
tests:
  aoszephyrapp.communication:
    build_only: false
    tags: smclient
    timeout: 500
    platform_allow: native_posix_64 native_posix
```

## tests/storage/testcase.yaml
```yaml
tests:
  aoszephyrapp.storage:
    tags: storage
    timeout: 500
    platform_allow: native_posix_64 native_posix
```
